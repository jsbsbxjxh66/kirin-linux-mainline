## Documentation/devicetree/bindings/clock/hisilicon,hi6421v600-clk.yaml
```yaml
# SPDX-License-Identifier: (GPL-2.0-only OR BSD-2-Clause)
%YAML 1.2
---
$id: http://devicetree.org/schemas/clock/hisilicon,hi6421v600-clk.yaml#
$schema: http://devicetree.org/meta-schemas/core.yaml#

title: HiSilicon Hi6421v600 PMIC audio clock gate

maintainers:
  - Mauro Carvalho Chehab <mchehab+huawei@kernel.org>

description: |
  The Hi6421v600 PMIC exposes a single audio clock gate in its SPMI register
  space.  The gate is controlled by a bit in an 8-bit PMIC register and is
  used as the parent clock of the Hi6403 codec controller and SLIMbus.

  The node must be a child of the Hi6421v600 PMIC MFD node, because the
  driver obtains the SPMI regmap from its parent device.

properties:
  compatible:
    const: hisilicon,hi6421v600-clk

  '#clock-cells':
    const: 0

  clocks:
    maxItems: 1

  clock-output-names:
    maxItems: 1

  hisilicon,clkgate:
    description:
      PMIC register offset and bit number controlling the gate.
    $ref: /schemas/types.yaml#/definitions/uint32-array
    items:
      - description: 8-bit PMIC register offset
      - description: gate bit, 0..7
    minItems: 2
    maxItems: 2

required:
  - compatible
  - '#clock-cells'
  - clocks
  - clock-output-names
  - hisilicon,clkgate

additionalProperties: false

examples:
  - |
    clk_24m: clock-24m {
        compatible = "fixed-clock";
        #clock-cells = <0>;
        clock-frequency = <19200000>;
    };

    pmic {
        #address-cells = <1>;
        #size-cells = <0>;

        clock {
            compatible = "hisilicon,hi6421v600-clk";
            #clock-cells = <0>;
            clocks = <&clk_24m>;
            clock-output-names = "clk_pmuaudioclk";
            hisilicon,clkgate = <0x3d 0>;
        };
    };
...
```

## Documentation/devicetree/bindings/display/hisilicon/hisi-dpe.yaml
```yaml
# SPDX-License-Identifier: (GPL-2.0-only OR BSD-2-Clause)
%YAML 1.2
---
$id: http://devicetree.org/schemas/display/hisilicon/hisi-dpe.yaml#
$schema: http://devicetree.org/meta-schemas/core.yaml#

maintainers:
  - Wei Xu <xuwei5@hisilicon.com>

title: HiSilicon Hi3670 DPE (Display Processing Engine)

description:
  DPE is the display controller on HiSilicon Hi3670 (Kirin 970) SoC.
  It grabs image data from memory, performs composition and post-processing,
  generates RGB timing stream and transfers to DSI.

properties:
  compatible:
    const: hisilicon,hi3670-dpe

  reg:
    minItems: 8
    maxItems: 8
    description: |
      Register regions:
        - DSS base (0xE8600000)
        - PERI CRG (0xFFF35000)
        - SCTRL (0xFFF0A000)
        - PCTRL (0xE8A09000)
        - NOC DSS (0xE86C0000)
        - MMBUF CFG (0xFFF02000)
        - PM Ctrl (0xFFF31000)
        - Media CRG (0xE87FF000)

  reg-names:
    items:
      - const: dss_base
      - const: peri_crg
      - const: sctrl
      - const: pctrl
      - const: noc_dss
      - const: mmbuf_crg
      - const: pmctrl
      - const: media_crg

  interrupts:
    minItems: 1
    maxItems: 4

  interrupt-names:
    minItems: 1
    maxItems: 4

  clocks:
    minItems: 9
    maxItems: 9

  clock-names:
    items:
      - const: dss_axi_clk
      - const: dss_pclk_dss_clk
      - const: dss_pri_clk
      - const: dss_pxl0_clk
      - const: dss_mmbuf_clk
      - const: dss_pclk_mmbuf
      - const: dss_dphy0_ref_clk
      - const: dss_dphy0_cfg_clk
      - const: dss_pclk_dsi0_clk

  resets:
    maxItems: 1

  port:
    $ref: /schemas/graph.yaml#/$defs/port-base
    unevaluatedProperties: false
    description: Output port to the DSI controller.

required:
  - compatible
  - reg
  - reg-names
  - interrupts
  - clocks
  - clock-names
  - port

additionalProperties: false

examples:
  - |
    #include <dt-bindings/clock/hi3670-clock.h>
    #include <dt-bindings/interrupt-controller/arm-gic.h>

    soc {
        #address-cells = <2>;
        #size-cells = <2>;

        display-engine@e8600000 {
            compatible = "hisilicon,hi3670-dpe";
            reg = <0x0 0xe8600000 0x0 0xc0000>,   /* DSS base */
                  <0x0 0xfff35000 0x0 0x1000>,     /* PERI CRG */
                  <0x0 0xfff0a000 0x0 0x1000>,     /* SCTRL */
                  <0x0 0xe8a09000 0x0 0x1000>,     /* PCTRL */
                  <0x0 0xe86c0000 0x0 0x10000>,    /* NOC DSS */
                  <0x0 0xfff02000 0x0 0x1000>,     /* MMBUF CFG */
                  <0x0 0xfff31000 0x0 0x1000>,     /* PM Ctrl */
                  <0x0 0xe87ff000 0x0 0x1000>;     /* Media CRG */
            reg-names = "dss_base", "peri_crg", "sctrl", "pctrl",
                        "noc_dss", "mmbuf_crg", "pmctrl", "media_crg";

            clocks = <&media1_crg HI3670_ACLK_GATE_DSS>,
                     <&media1_crg HI3670_PCLK_GATE_DSS>,
                     <&media1_crg HI3670_CLK_GATE_EDC0>,
                     <&media1_crg HI3670_CLK_GATE_LDI0>,
                     <&media1_crg HI3670_CLK_GATE_DSS_AXI_MM>,
                     <&media1_crg HI3670_PCLK_GATE_MMBUF_CFG>,
                     <&crg_ctrl HI3670_CLK_GATE_TXDPHY0_REF>,
                     <&crg_ctrl HI3670_CLK_GATE_TXDPHY0_CFG>,
                     <&crg_ctrl HI3670_PCLK_GATE_DSI0>;
            clock-names = "dss_axi_clk", "dss_pclk_dss_clk",
                          "dss_pri_clk", "dss_pxl0_clk",
                          "dss_mmbuf_clk", "dss_pclk_mmbuf",
                          "dss_dphy0_ref_clk", "dss_dphy0_cfg_clk",
                          "dss_pclk_dsi0_clk";

            interrupts = <GIC_SPI 245 IRQ_TYPE_LEVEL_HIGH>;
            interrupt-names = "dpe_pdp";

            resets = <&media_ctrl 0x44>;

            port {
                endpoint {
                };
            };
        };
    };
```

## Documentation/devicetree/bindings/display/hisilicon/hisi-dsi.yaml
```yaml
# SPDX-License-Identifier: (GPL-2.0-only OR BSD-2-Clause)
%YAML 1.2
---
$id: http://devicetree.org/schemas/display/hisilicon/hisi-dsi.yaml#
$schema: http://devicetree.org/meta-schemas/core.yaml#

maintainers:
  - Wei Xu <xuwei5@hisilicon.com>

title: HiSilicon Hi3670 DSI Host Controller

description:
  DesignWare DSI Host Controller v410 on HiSilicon Hi3670 (Kirin 970) SoC.

properties:
  compatible:
    const: hisilicon,hi3670-dsi

  reg:
    items:
      - description: DSI controller registers

  clocks:
    items:
      - description: DSI APB clock

  clock-names:
    items:
      - const: pclk

  resets:
    maxItems: 1

  reset-names:
    items:
      - const: apb

  dsi-bit-clk-mhz:
    description: |
      D-PHY DDR bit clock per lane in MHz. The lane data rate is twice this
      value. The panel runs in burst mode, so this is not derived from the
      pixel clock.

  '#address-cells':
    const: 1

  '#size-cells':
    const: 0

  port:
    $ref: /schemas/graph.yaml#/$defs/port-base
    unevaluatedProperties: false
    description: Input port connecting to the DPE output.

  port@1:
    $ref: /schemas/graph.yaml#/$defs/port-base
    unevaluatedProperties: false
    description: Output port connecting to the panel.

patternProperties:
  '^panel@[0-9]+$':
    oneOf:
      - $ref: /schemas/display/panel/hisi,td4320.yaml#
      - $ref: /schemas/display/panel/hisi,ft8719.yaml#

required:
  - compatible
  - reg
  - clocks
  - clock-names
  - resets
  - reset-names
  - port

additionalProperties: false

examples:
  - |
    #include <dt-bindings/clock/hi3670-clock.h>

    soc {
        #address-cells = <2>;
        #size-cells = <2>;

        dsi@e8601000 {
            compatible = "hisilicon,hi3670-dsi";
            reg = <0x0 0xe8601000 0x0 0x400>;

            #address-cells = <1>;

            clocks = <&crg_ctrl HI3670_PCLK_GATE_DSI0>;
            clock-names = "pclk";

            dsi-bit-clk-mhz = <562>;

            resets = <&crg_rst 0x84 28>;
            reset-names = "apb";

            #size-cells = <0>;

            port {
                endpoint {
                };
            };

            port@1 {
                reg = <1>;

                endpoint {
                };
            };
        };
    };
```

## Documentation/devicetree/bindings/display/panel/hisi,ft8719.yaml
```yaml
# SPDX-License-Identifier: (GPL-2.0-only OR BSD-2-Clause)
%YAML 1.2
---
$id: http://devicetree.org/schemas/display/panel/hisi,ft8719.yaml#
$schema: http://devicetree.org/meta-schemas/core.yaml#

title: Hisilicon-adapted BOE FT8719 MIPI-DSI panel

maintainers:
  - Wei Xu <xuwei5@hisilicon.com>

description: |
  BOE FT8719 6.3" 1080x2340 video-mode MIPI-DSI panel, the sibling variant
  of the TD4320 fitted to the Honor Play (COR-AL00). Both share the same
  glass, 3 data lanes, 562 Mbps per lane and RGB888, but differ in porches,
  reset timing and init sequence.

  The vendor prefix is "hisi" for symmetry with "hisi,td4320" and to stay
  clear of upstream's "ebbg,ft8719"
  (drivers/gpu/drm/panel/panel-ebbg-ft8719.c), which describes a different
  1080x2246 panel with its own supply names.

allOf:
  - $ref: panel-common.yaml#

properties:
  compatible:
    const: hisi,ft8719

  reg:
    maxItems: 1
    description: DSI virtual channel of the peripheral

  reset-gpios:
    description: |
      Panel reset, active low. The driver's probe default is
      GPIOD_OUT_HIGH, i.e. the panel boots held in reset until the
      prepare sequence releases it.

  iovcc-supply:
    description: 1.8 V MIPI I/O rail

  vsp-supply:
    description: |
      Positive bias rail (+5.5 V). Optional - on the COR-AL00 it comes
      from an on-board bias IC with no mainline driver, so it is left
      unbound and the driver tolerates its absence.

  vsn-supply:
    description: Negative bias rail (-5.5 V), same caveat as vsp-supply

required:
  - compatible
  - reg
  - reset-gpios
  - port

unevaluatedProperties: false

examples:
  - |
    #include <dt-bindings/gpio/gpio.h>

    dsi {
        #address-cells = <1>;
        #size-cells = <0>;

        panel@0 {
            compatible = "hisi,ft8719";
            reg = <0>;

            backlight = <&backlight>;
            iovcc-supply = <&ldo4>;

            reset-gpios = <&gpio3 5 GPIO_ACTIVE_LOW>;

            port {
                endpoint {
                    remote-endpoint = <&dsi_out>;
                };
            };
        };
    };

...
```

## Documentation/devicetree/bindings/display/panel/hisi,td4320.yaml
```yaml
# SPDX-License-Identifier: (GPL-2.0-only OR BSD-2-Clause)
%YAML 1.2
---
$id: http://devicetree.org/schemas/display/panel/hisi,td4320.yaml#
$schema: http://devicetree.org/meta-schemas/core.yaml#

title: Hisilicon-adapted BOE TD4320 MIPI-DSI panel

maintainers:
  - Wei Xu <xuwei5@hisilicon.com>

description: |
  BOE TD4320 6.3" 1080x2340 video-mode MIPI-DSI panel as wired on the
  Honor Play (COR-AL00).

  The vendor prefix is "hisi" rather than "boe" because upstream already
  binds "boe,td4320" (drivers/gpu/drm/panel/panel-boe-td4320.yaml) to the
  same glass on the Xiaomi Redmi Note 7, where it runs as 4 data lanes in
  video burst mode. The COR-AL00 runs it as 3 data lanes with sync pulses
  and carries a different init sequence, so it needs its own binding and
  its own driver: drivers/gpu/drm/hisilicon/hisi_dpe/panel-hisi-td4320.c.

allOf:
  - $ref: panel-common.yaml#

properties:
  compatible:
    const: hisi,td4320

  reg:
    maxItems: 1
    description: DSI virtual channel of the peripheral

  reset-gpios:
    description: |
      Panel reset, active low. The driver's probe default is
      GPIOD_OUT_HIGH, i.e. the panel boots held in reset until the
      prepare sequence releases it.

  iovcc-supply:
    description: 1.8 V MIPI I/O rail

  vsp-supply:
    description: |
      Positive bias rail (+5.5 V). Optional - on the COR-AL00 it comes
      from an on-board bias IC with no mainline driver, so it is left
      unbound and the driver tolerates its absence.

  vsn-supply:
    description: Negative bias rail (-5.5 V), same caveat as vsp-supply

required:
  - compatible
  - reg
  - reset-gpios
  - port

unevaluatedProperties: false

examples:
  - |
    #include <dt-bindings/gpio/gpio.h>

    dsi {
        #address-cells = <1>;
        #size-cells = <0>;

        panel@0 {
            compatible = "hisi,td4320";
            reg = <0>;

            backlight = <&backlight>;
            iovcc-supply = <&ldo4>;

            reset-gpios = <&gpio3 5 GPIO_ACTIVE_LOW>;

            port {
                endpoint {
                    remote-endpoint = <&dsi_out>;
                };
            };
        };
    };

...
```

## Documentation/devicetree/bindings/iio/adc/hisilicon,hi3670-hkadc.yaml
```yaml
# SPDX-License-Identifier: (GPL-2.0 OR BSD-2-Clause)
%YAML 1.2
---
$id: http://devicetree.org/schemas/iio/adc/hisilicon,hi3670-hkadc.yaml#
$schema: http://devicetree.org/meta-schemas/core.yaml#

title: HiSilicon Hi3670 HKADC

maintainers:
  - Wei Xu <xuwei5@hisilicon.com>

description: |
  The Hi3670 HKADC (housekeeping ADC) is owned by the LPM3 firmware.  The AP
  requests a conversion over the HiIPCV230 mailbox and receives the result on
  the matching receive channel.

properties:
  compatible:
    const: hisilicon,hi3670-hkadc

  mboxes:
    items:
      - description: mailbox channel used to send conversion requests to LPM3
      - description: mailbox channel used to receive conversion results

  mbox-names:
    items:
      - const: tx
      - const: rx

  "#io-channel-cells":
    const: 1

required:
  - compatible
  - mboxes
  - mbox-names
  - "#io-channel-cells"

additionalProperties: false

examples:
  - |
    adc {
        compatible = "hisilicon,hi3670-hkadc";
        mboxes = <&mailbox 16>, <&mailbox 0>;
        mbox-names = "tx", "rx";
        #io-channel-cells = <1>;
    };
...
```

## Documentation/devicetree/bindings/input/hisilicon,hi6421v600-powerkey.yaml
```yaml
# SPDX-License-Identifier: (GPL-2.0-only OR BSD-2-Clause)
%YAML 1.2
---
$id: http://devicetree.org/schemas/input/hisilicon,hi6421v600-powerkey.yaml#
$schema: http://devicetree.org/meta-schemas/core.yaml#

title: Hisilicon Hi6421v600 PMIC power key

maintainers:
  - Wei Xu <xuwei5@hisilicon.com>

description:
  The Hi6421v600 PMIC exposes the power key press, release and long-hold
  interrupts. The long-hold interrupt is reported as KEY_RESTART.

properties:
  compatible:
    const: hisilicon,hi6421v600-powerkey

  interrupts:
    maxItems: 3

  interrupt-names:
    items:
      - const: down
      - const: up
      - const: hold 4s

required:
  - compatible
  - interrupts
  - interrupt-names

additionalProperties: false
```

## Documentation/devicetree/bindings/input/regulator-vibrator.yaml
```yaml
# SPDX-License-Identifier: (GPL-2.0-only OR BSD-2-Clause)
%YAML 1.2
---
$id: http://devicetree.org/schemas/input/regulator-vibrator.yaml#
$schema: http://devicetree.org/meta-schemas/core.yaml#

title: Regulator vibrator

maintainers:
  - opencode <opencode@localhost>

description: |
  A vibrator motor whose power is enabled and disabled through a regulator.

properties:
  compatible:
    const: regulator-vibrator

  vcc-supply:
    description: Regulator that powers the vibrator motor.

  vibrator-voltage-microvolt:
    description: Optional voltage to configure on the supply when present.

required:
  - compatible
  - vcc-supply

additionalProperties: false

examples:
  - |
    vibrator {
        compatible = "regulator-vibrator";
        vcc-supply = <&ldo17>;
        vibrator-voltage-microvolt = <3000000>;
    };
```
