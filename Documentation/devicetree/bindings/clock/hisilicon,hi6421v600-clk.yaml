## Documentation/devicetree/bindings/power/supply/hisilicon,hi6421v600-coul.yaml
```yaml
# SPDX-License-Identifier: (GPL-2.0-only OR BSD-2-Clause)
%YAML 1.2
---
$id: http://devicetree.org/schemas/power/supply/hisilicon,hi6421v600-coul.yaml#
$schema: http://devicetree.org/meta-schemas/core.yaml#

title: Hisilicon Hi6421v600 PMIC coulomb counter

maintainers:
  - Wei Xu <xuwei5@hisilicon.com>

description:
  The Hi6421v600 PMIC coulomb counter reports battery charge and the
  battery insertion/removal interrupt.

properties:
  compatible:
    const: hisilicon,hi6421v600-coul

  interrupts:
    maxItems: 1

  interrupt-names:
    const: coulirq

required:
  - compatible
  - interrupts
  - interrupt-names

additionalProperties: false
```

## Documentation/devicetree/bindings/remoteproc/hisilicon,hi3670-isp-rproc.yaml
```yaml
# SPDX-License-Identifier: (GPL-2.0-only OR BSD-2-Clause)
%YAML 1.2
---
$id: http://devicetree.org/schemas/remoteproc/hisilicon,hi3670-isp-rproc.yaml#
$schema: http://devicetree.org/meta-schemas/core.yaml#

title: Hisilicon Hi3670 ISP remote processor

maintainers:
  - linux-kernel@vger.kernel.org

description: |
  The Hi3670 ISP block contains a Cortex-A7 remote processor and an ISP
  core.  The A7 runs the ISP firmware and accesses memory through a
  Hisilicon SMMU that is programmed by the host.

properties:
  compatible:
    const: hisilicon,isp

  reg:
    minItems: 1
    maxItems: 9
    description: |
      Register windows: ISP core first, then PERI_CRG, PMC, PCTRL, SCTRL,
      NOC, CSSYS, ISP sub control and ISP WDT.  Only the ISP core window is
      owned exclusively by this device; the others are shared register
      blocks mapped read/write without requesting them.

  interrupts:
    maxItems: 1

  mboxes:
    maxItems: 2
    description: |
      AP-to-ISP and ISP-to-AP mailbox channels.  The first is used to kick
      a virtqueue, the second delivers virtqueue indices from firmware.

  mbox-names:
    items:
      - const: tx
      - const: rx

  firmware-name:
    description: Name of the ISP firmware ELF image.

  hisilicon,isp-name:
    $ref: /schemas/types.yaml#/definitions/string
    description: Name used for the remote processor.

  hisilicon,isp-remap-addr:
    $ref: /schemas/types.yaml#/definitions/uint64
    description: Address written to the ISP A7 remap register at boot.

  clocks:
    maxItems: 3

  clock-names:
    items:
      - const: ispcpu
      - const: ispfunc
      - const: ispi2c

  core-supply:
    description: ISP core power supply.

  clockdep-supply:
    description: Supply that must be on before the ISP clocks are enabled.

  iommu-info:
    type: object
    additionalProperties: false
    description: IOVA window managed by the ISP SMMU.
    properties:
      start-addr:
        $ref: /schemas/types.yaml#/definitions/uint32
      size:
        $ref: /schemas/types.yaml#/definitions/uint32
    required:
      - start-addr
      - size

required:
  - compatible
  - reg
  - interrupts

additionalProperties: false

examples:
  - |
    #include <dt-bindings/interrupt-controller/arm-gic.h>

    isp@e8400000 {
        compatible = "hisilicon,isp";
        reg = <0x0 0xe8400000 0x0 0x200000>,
              <0x0 0xfff35000 0x0 0x1000>,
              <0x0 0xfff31000 0x0 0x1000>,
              <0x0 0xe8a09000 0x0 0x1000>,
              <0x0 0xfff0a000 0x0 0x1000>,
              <0x0 0xe86d0000 0x0 0x1000>,
              <0x0 0xec050000 0x0 0x2000>,
              <0x0 0xe8583000 0x0 0x1000>,
              <0x0 0xe8580000 0x0 0x1000>;
        interrupts = <GIC_SPI 272 IRQ_TYPE_LEVEL_HIGH>;
        firmware-name = "isp_fw.elf";
        hisilicon,isp-name = "ISPCPU";
        hisilicon,isp-remap-addr = <0x0>;
        status = "disabled";

        iommu-info {
            start-addr = <0xc0000000>;
            size = <0x3ffffc00>;
        };
    };
```

## Documentation/devicetree/bindings/rtc/hisilicon,hi6421v600-rtc.yaml
```yaml
# SPDX-License-Identifier: (GPL-2.0-only OR BSD-2-Clause)
%YAML 1.2
---
$id: http://devicetree.org/schemas/rtc/hisilicon,hi6421v600-rtc.yaml#
$schema: http://devicetree.org/meta-schemas/core.yaml#

title: Hisilicon Hi6421v600 PMIC RTC

maintainers:
  - Wei Xu <xuwei5@hisilicon.com>

description:
  The Hi6421v600 PMIC provides the battery-backed real-time clock and alarm.
  An optional SoC RTC child provides a second time source and alarm interrupt.

properties:
  compatible:
    const: hisilicon,hi6421v600-rtc

  interrupts:
    maxItems: 1

  interrupt-names:
    const: hisi-pmic-rtc

  hisilicon,pmic-rtc-base:
    $ref: /schemas/types.yaml#/definitions/uint32
    description: PMIC RTC register base address.

  hisilicon,pmic-rtc-imr:
    $ref: /schemas/types.yaml#/definitions/uint32
    description: PMIC RTC interrupt mask register.

  hisilicon,pmic-rtc-icr:
    $ref: /schemas/types.yaml#/definitions/uint32
    description: PMIC RTC interrupt clear register.

  hisilicon,pmic-rtc-ib:
    $ref: /schemas/types.yaml#/definitions/uint32
    description: PMIC RTC interrupt bank.

  hisilicon,pmic-rtc-xo-thrshd-pwroff-val:
    $ref: /schemas/types.yaml#/definitions/uint32
    description: PMIC RTC crystal oscillator power-off threshold.

  soc-rtc:
    type: object
    description: SoC RTC used as a secondary time source.

    properties:
      compatible:
        const: hisilicon,soc-rtc

      soc-rtc-baseaddr:
        $ref: /schemas/types.yaml#/definitions/uint32
        description: SoC RTC register base address.

      interrupts:
        maxItems: 1

    required:
      - compatible
      - soc-rtc-baseaddr
      - interrupts

    additionalProperties: false

required:
  - compatible
  - interrupts
  - interrupt-names
  - hisilicon,pmic-rtc-base
  - hisilicon,pmic-rtc-imr
  - hisilicon,pmic-rtc-icr
  - hisilicon,pmic-rtc-ib
  - hisilicon,pmic-rtc-xo-thrshd-pwroff-val
  - soc-rtc

additionalProperties: false
```

## Documentation/devicetree/bindings/slimbus/hisilicon,hi3670-slimbus.yaml
```yaml
# SPDX-License-Identifier: (GPL-2.0-only OR BSD-2-Clause)
%YAML 1.2
---
$id: http://devicetree.org/schemas/slimbus/hisilicon,hi3670-slimbus.yaml#
$schema: http://devicetree.org/meta-schemas/core.yaml#

title: Hisilicon Hi3670 ASP SLIMbus controller

maintainers:
  - Wei Xu <xuwei5@hisilicon.com>

description:
  The ASP SLIMbus controller integrates a Cadence SLIMbus controller with the
  Hisilicon ASP subsystem. The controller provides the SLIMbus clock and data
  lines used by the Hi6403 audio codec.

properties:
  compatible:
    const: hisilicon,hi3670-slimbus

  reg:
    maxItems: 3

  interrupts:
    maxItems: 1

  interrupt-names:
    const: asp_irq_slimbus

  slimbus-reg-supply:
    description: Regulator supplying the SLIMbus I/O rail.

  clocks:
    maxItems: 2

  clock-names:
    items:
      - const: clk_pmuaudioclk
      - const: clk_asp_subsys

  pinctrl-names:
    items:
      - const: default
      - const: idle

  pinctrl-0: true

  pinctrl-1: true

  asp_power_state_offset:
    $ref: /schemas/types.yaml#/definitions/uint32
    description: ASP subsystem power state register offset.

  asp_clk_state_offset:
    $ref: /schemas/types.yaml#/definitions/uint32
    description: ASP subsystem clock state register offset.

  slimbusclk_io_driver:
    $ref: /schemas/types.yaml#/definitions/uint32
    description: SLIMbus clock pin drive strength configuration.

  slimbusdata_io_driver:
    $ref: /schemas/types.yaml#/definitions/uint32
    description: SLIMbus data pin drive strength configuration.

  slimbusclk_offset:
    $ref: /schemas/types.yaml#/definitions/uint32
    description: SLIMbus clock pad register offset.

  slimbusdata_offset:
    $ref: /schemas/types.yaml#/definitions/uint32
    description: SLIMbus data pad register offset.

  slimbusclk_cfg_offset:
    $ref: /schemas/types.yaml#/definitions/uint32
    description: SLIMbus clock pad configuration register offset.

  slimbusdata_cfg_offset:
    $ref: /schemas/types.yaml#/definitions/uint32
    description: SLIMbus data pad configuration register offset.

  platform-type:
    enum: [ASIC, FPGA]
    default: ASIC

  codec-type:
    $ref: /schemas/types.yaml#/definitions/string
    description: Codec type attached to the SLIMbus controller.

  clk_asp_subsys:
    $ref: /schemas/types.yaml#/definitions/uint32
    description: ASP subsystem clock rate in Hz.

  slimbus_dynamic_freq:
    $ref: /schemas/types.yaml#/definitions/string
    enum: ["true", "false"]
    description: Whether the SLIMbus clock frequency is changed dynamically.

  pm_runtime_support:
    type: boolean
    description: Enable runtime PM for the controller.

  switch_framer_disable:
    type: boolean
    description: Disable switching the SLIMbus framer.

  hi6402-soundtrigger-if1-used:
    type: boolean
    description: Use the Hi6402 sound trigger interface 1 wiring.

required:
  - compatible
  - reg
  - interrupts
  - interrupt-names
  - clocks
  - clock-names

additionalProperties: false
```

## Documentation/devicetree/bindings/soc/hisilicon/hisilicon,bl31-shared-memory.yaml
```yaml
# SPDX-License-Identifier: (GPL-2.0-only OR BSD-2-Clause)
%YAML 1.2
---
$id: http://devicetree.org/schemas/soc/hisilicon/hisilicon,bl31-shared-memory.yaml#
$schema: http://devicetree.org/meta-schemas/core.yaml#

title: HiSilicon BL31 shared memory windows

maintainers:
  - Wei Xu <xuwei5@hisilicon.com>

description: |
  The ARM Trusted Firmware BL31 exposes a small shared memory window to the
  non-secure world.  Each child node describes a window inside that region;
  the child reg property holds an offset and a size relative to
  HISI_SUB_RESERVED_BL31_SHARE_MEM_PHYMEM_BASE, not a CPU address.

properties:
  compatible:
    const: hisilicon,bl31-shared-memory

  "#address-cells":
    const: 1

  "#size-cells":
    const: 1

patternProperties:
  "^[a-z0-9-]+@[0-9a-f]+$":
    type: object
    properties:
      compatible:
        enum:
          - hisi,share-memory-drm
      reg:
        maxItems: 1
        description: Offset and size inside the BL31 shared window.
    required:
      - compatible
      - reg
    additionalProperties: false

required:
  - compatible
  - "#address-cells"
  - "#size-cells"

additionalProperties: false
```

## Documentation/devicetree/bindings/soc/hisilicon/hisilicon,ddr-secprotect.yaml
```yaml
# SPDX-License-Identifier: (GPL-2.0-only OR BSD-2-Clause)
%YAML 1.2
---
$id: http://devicetree.org/schemas/soc/hisilicon/hisilicon,ddr-secprotect.yaml#
$schema: http://devicetree.org/meta-schemas/core.yaml#

title: HiSilicon DDR secure protection and DMSS FIQ reporting

maintainers:
  - Wei Xu <xuwei5@hisilicon.com>

description: |
  The secure monitor owns the DDR firewall.  Linux programs dynamic secure
  regions through a descriptor placed in the BL31 shared memory window and
  an SMC.  The DMSS reports violations through an FIQ and publishes the
  source flag in the same shared window.

properties:
  compatible:
    const: hisilicon,ddr_secprotect

  reg:
    maxItems: 1
    description: DMSS register window.

  interrupts:
    maxItems: 1
    description: DMSS FIQ, if wired as a normal interrupt.

required:
  - compatible
  - reg

additionalProperties: false
```

## Documentation/devicetree/bindings/soc/hisilicon/hisilicon,hisi-hhee.yaml
```yaml
# SPDX-License-Identifier: (GPL-2.0-only OR BSD-2-Clause)
%YAML 1.2
---
$id: http://devicetree.org/schemas/soc/hisilicon/hisilicon,hisi-hhee.yaml#
$schema: http://devicetree.org/meta-schemas/core.yaml#

title: HiSilicon HHEE hypervisor interface

maintainers:
  - Wei Xu <xuwei5@hisilicon.com>

description: |
  The HiSilicon Hypervisor Execution Environment (HHEE) runs at EL2 and
  reports exceptions and firmware messages to the non-secure kernel through
  a shared message queue.  The kernel acknowledges messages through the
  interrupt described below.

properties:
  compatible:
    const: hisilicon,hisi-hhee

  interrupts:
    maxItems: 1

required:
  - compatible
  - interrupts

additionalProperties: false

examples:
  - |
    #include <dt-bindings/interrupt-controller/arm-gic.h>

    hhee {
        compatible = "hisilicon,hisi-hhee";
        interrupts = <GIC_SPI 350 IRQ_TYPE_LEVEL_HIGH>;
    };
```

## Documentation/devicetree/bindings/soc/hisilicon/hisilicon,hw-vote.yaml
```yaml
# SPDX-License-Identifier: (GPL-2.0-only OR BSD-2-Clause)
%YAML 1.2
---
$id: http://devicetree.org/schemas/soc/hisilicon/hisilicon,hw-vote.yaml#
$schema: http://devicetree.org/meta-schemas/core.yaml#

title: HiSilicon hardware frequency vote aggregator

maintainers:
  - Wei Xu <xuwei5@hisilicon.com>

description: |
  The HiSilicon PMCTRL block aggregates frequency votes from several
  masters and exposes the winning value.  Each channel describes one
  frequency domain (for example a CPU cluster or the GPU); the vote
  sources below a channel are the individual register fields written by
  consumers.

properties:
  compatible:
    const: hisi,freq-hw-vote

  reg:
    maxItems: 1
    description: PMCTRL register window containing the vote registers.

  "#address-cells":
    const: 2

  "#size-cells":
    const: 2

  ranges: true

patternProperties:
  '^[a-z0-9-]+-freq$':
    type: object
    description: A frequency domain and its vote sources.

    properties:
      result_reg:
        $ref: /schemas/types.yaml#/definitions/uint32-array
        minItems: 3
        maxItems: 3
        description:
          Register offset, read mask and write mask of the aggregated
          result register.

      ratio:
        $ref: /schemas/types.yaml#/definitions/uint32
        default: 1
        description: Frequency encoding ratio for this channel.

    patternProperties:
      '^vote-src-[0-9]+$':
        type: object
        description: One vote register field owned by a consumer.

        properties:
          vote_reg:
            $ref: /schemas/types.yaml#/definitions/uint32-array
            minItems: 3
            maxItems: 3
            description:
              Register offset, read mask and write mask of the vote
              register field.

        required:
          - vote_reg

        additionalProperties: false

    required:
      - result_reg

    additionalProperties: false

required:
  - compatible
  - reg

additionalProperties: false
```

## Documentation/devicetree/bindings/soc/hisilicon/hisilicon,k3hifidsp.yaml
```yaml
# SPDX-License-Identifier: (GPL-2.0-only OR BSD-2-Clause)
%YAML 1.2
---
$id: http://devicetree.org/schemas/soc/hisilicon/hisilicon,k3hifidsp.yaml#
$schema: http://devicetree.org/meta-schemas/core.yaml#

title: Hisilicon Kirin HiFi DSP control

maintainers:
  - Wei Xu <xuwei5@hisilicon.com>

description:
  The HiFi DSP control node represents the always-on control interface for
  the Kirin HiFi DSP. The DSP firmware and shared data region are managed by
  the bootloader; this node only selects the platform type used by the
  mailbox protocol.

properties:
  compatible:
    const: hisilicon,k3hifidsp

  platform-type:
    enum: [ASIC, FPGA]
    default: ASIC

required:
  - compatible

additionalProperties: false
```
