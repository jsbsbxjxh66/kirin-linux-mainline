## Documentation/devicetree/bindings/input/touchscreen/syna,tcm-spi.yaml
```yaml
# SPDX-License-Identifier: (GPL-2.0-only OR BSD-2-Clause)
%YAML 1.2
---
$id: http://devicetree.org/schemas/input/touchscreen/syna,tcm-spi.yaml#
$schema: http://devicetree.org/meta-schemas/core.yaml#

title: Synaptics Touch Controller Module (TCM) on SPI

description:
  Synaptics TCM touch controllers speak the TCM message protocol over SPI.
  Ramless parts only run the F$35 microbootloader after reset and need the
  host to download the application firmware into PMEM before touch reports
  are available; "syna,firmware-name" names that image.

maintainers:
  - "Mainline port for Hi3670 COR-AL00 <noreply@example.com>"

allOf:
  - $ref: touchscreen.yaml#
  - $ref: /schemas/spi/spi-peripheral-props.yaml#

properties:
  compatible:
    const: syna,tcm-spi

  reg:
    maxItems: 1

  interrupts:
    maxItems: 1

  reset-gpios:
    maxItems: 1
    description:
      Reset line, active low unless the board wires it differently.

  spi-cpol: true
  spi-cpha: true

  vdd-supply: true

  vddio-supply: true

  syna,firmware-name:
    description:
      Firmware image to load into the controller's PMEM, relative to the
      firmware search path.  For the COR-AL00 panel this is
      "ts/corn_synaptics_tcm_corn69130.img".
    $ref: /schemas/types.yaml#/definitions/string

  syna,max-objects:
    description: Maximum number of concurrent touch objects.
    $ref: /schemas/types.yaml#/definitions/uint32
    minimum: 1
    maximum: 10
    default: 10

  syna,reset-active-ms:
    description: Time the controller is held in reset.
    default: 20

  syna,reset-delay-ms:
    description: Time to wait after releasing reset before talking to the chip.
    default: 200

required:
  - compatible
  - reg
  - interrupts
  - syna,firmware-name

unevaluatedProperties: false

examples:
  - |
    #include <dt-bindings/gpio/gpio.h>
    #include <dt-bindings/interrupt-controller/irq.h>

    spi {
        #address-cells = <1>;
        #size-cells = <0>;

        touchscreen@0 {
            compatible = "syna,tcm-spi";
            reg = <0>;
            spi-max-frequency = <10000000>;
            spi-cpol;
            spi-cpha;
            interrupt-parent = <&gpio26>;
            interrupts = <4 IRQ_TYPE_LEVEL_LOW>;
            reset-gpios = <&gpio1 7 GPIO_ACTIVE_LOW>;
            touchscreen-size-x = <1080>;
            touchscreen-size-y = <2340>;
            syna,max-objects = <10>;
            syna,reset-active-ms = <20>;
            syna,reset-delay-ms = <200>;
            syna,firmware-name = "ts/corn_synaptics_tcm_corn69130.img";
        };
    };
```

## Documentation/devicetree/bindings/iommu/hisilicon,hisi-smmu-lpae.yaml
```yaml
# SPDX-License-Identifier: (GPL-2.0-only OR BSD-2-Clause)
%YAML 1.2
---
$id: http://devicetree.org/schemas/iommu/hisilicon,hisi-smmu-lpae.yaml#
$schema: http://devicetree.org/meta-schemas/core.yaml#

title: Hisilicon LPAE SMMU page-table manager

maintainers:
  - Wei Xu <xuwei5@hisilicon.com>

description: |
  The SMMU hardware on Hisilicon Kirin SoCs is configured by the secure
  firmware and by the consumer drivers, which program TTBR0 themselves.
  The AP only owns the shared three-level page tables.  This node therefore
  has no register range or interrupt.

properties:
  compatible:
    const: hisi,hisi-smmu-lpae

  "#iommu-cells":
    const: 0
    description:
      The SMMU uses a single shared page table per consumer domain, so no
      stream ID is encoded in the phandle.

required:
  - compatible
  - "#iommu-cells"

additionalProperties: false

examples:
  - |
    smmu_lpae: iommu {
        compatible = "hisi,hisi-smmu-lpae";
        #iommu-cells = <0>;
    };
```

## Documentation/devicetree/bindings/leds/hisilicon,hi6421v600-led.yaml
```yaml
# SPDX-License-Identifier: (GPL-2.0-only OR BSD-2-Clause)
%YAML 1.2
---
$id: http://devicetree.org/schemas/leds/hisilicon,hi6421v600-led.yaml#
$schema: http://devicetree.org/meta-schemas/core.yaml#

title: Hi6421v600 PMIC LED controller

maintainers:
  - opencode <opencode@localhost>

description: |
  The Hi6421v600 PMIC exposes three LED current sinks (red, green and blue).
  Each sink has its own ISET, start-delay and time-config registers, while
  enable and output control are shared.

properties:
  compatible:
    const: hisilicon,hi6421v600-led

  hisilicon,ctrl-reg:
    $ref: /schemas/types.yaml#/definitions/uint32
    description: Register offset of the global LED enable register.

  hisilicon,out-ctrl-reg:
    $ref: /schemas/types.yaml#/definitions/uint32
    description: Register offset of the LED output control register.

  "#address-cells":
    const: 1

  "#size-cells":
    const: 0

patternProperties:
  "^led@[0-2]$":
    type: object
    $ref: common.yaml#
    unevaluatedProperties: false

    properties:
      reg:
        description: Index of the LED current sink.
        minimum: 0
        maximum: 2

      hisilicon,max-current:
        $ref: /schemas/types.yaml#/definitions/uint32
        description: Value written to the ISET register for full brightness.

required:
  - compatible
  - hisilicon,ctrl-reg
  - hisilicon,out-ctrl-reg
  - "#address-cells"
  - "#size-cells"

additionalProperties: false

examples:
  - |
    #include <dt-bindings/leds/common.h>

    led-controller {
        compatible = "hisilicon,hi6421v600-led";
        #address-cells = <1>;
        #size-cells = <0>;
        hisilicon,ctrl-reg = <0x12f>;
        hisilicon,out-ctrl-reg = <0x133>;

        led@0 {
            reg = <0>;
            color = <LED_COLOR_ID_RED>;
            function = LED_FUNCTION_STATUS;
            hisilicon,max-current = <4>;
        };

        led@1 {
            reg = <1>;
            color = <LED_COLOR_ID_GREEN>;
            function = LED_FUNCTION_STATUS;
            hisilicon,max-current = <0>;
        };

        led@2 {
            reg = <2>;
            color = <LED_COLOR_ID_BLUE>;
            function = LED_FUNCTION_STATUS;
            hisilicon,max-current = <2>;
        };
    };
```

## Documentation/devicetree/bindings/leds/huawei,flash-led.yaml
```yaml
# SPDX-License-Identifier: (GPL-2.0-only OR BSD-2-Clause)
%YAML 1.2
---
$id: http://devicetree.org/schemas/leds/huawei,flash-led.yaml#
$schema: http://devicetree.org/meta-schemas/core.yaml#

title: Huawei LM3642/MP3331/AW3642 flash and torch LED

maintainers:
  - opencode <opencode@localhost>

description: |
  Several pin-compatible flash LED controllers are used across Huawei phone
  revisions.  The controller is identified from its chip ID register at probe
  time, so a single compatible covers all of them.

properties:
  compatible:
    const: huawei,flash-led

  reg:
    maxItems: 1

  led:
    type: object
    $ref: common.yaml#
    unevaluatedProperties: false

    required:
      - flash-max-microamp
      - flash-max-timeout-us

required:
  - compatible
  - reg
  - led

additionalProperties: false

examples:
  - |
    #include <dt-bindings/leds/common.h>

    i2c {
        #address-cells = <1>;
        #size-cells = <0>;

        flash@63 {
            compatible = "huawei,flash-led";
            reg = <0x63>;

            led {
                function = LED_FUNCTION_FLASH;
                color = <LED_COLOR_ID_WHITE>;
                flash-max-microamp = <1500000>;
                flash-max-timeout-us = <600000>;
                led-max-microamp = <375000>;
            };
        };
    };
```

## Documentation/devicetree/bindings/mfd/hisilicon,hi6421-spmi-pmic.yaml
```yaml
# SPDX-License-Identifier: GPL-2.0
%YAML 1.2
---
$id: http://devicetree.org/schemas/mfd/hisilicon,hi6421-spmi-pmic.yaml#
$schema: http://devicetree.org/meta-schemas/core.yaml#

title: HiSilicon 6421v600 SPMI PMIC

maintainers:
  - Mauro Carvalho Chehab <mchehab+huawei@kernel.org>

description: |
  HiSilicon 6421v600 should be connected inside a MIPI System Power Management
  (SPMI) bus. It provides interrupts and power supply.

  The GPIO and interrupt settings are represented as part of the top-level PMIC
  node.

  The SPMI controller part is provided by
  Documentation/devicetree/bindings/spmi/hisilicon,hisi-spmi-controller.yaml

properties:
  $nodename:
    pattern: "pmic@[0-9a-f]"

  compatible:
    const: hisilicon,hi6421v600-spmi

  reg:
    maxItems: 1

  '#interrupt-cells':
    const: 2

  interrupt-controller: true

  interrupts:
    maxItems: 1

  clock:
    $ref: /schemas/clock/hisilicon,hi6421v600-clk.yaml#

  coul:
    $ref: /schemas/power/supply/hisilicon,hi6421v600-coul.yaml#

  pmic-mntn:
    $ref: /schemas/mfd/hisilicon,hi6421v600-mntn.yaml#

  ponkey:
    $ref: /schemas/input/hisilicon,hi6421v600-powerkey.yaml#

  rtc:
    $ref: /schemas/rtc/hisilicon,hi6421v600-rtc.yaml#

  led-controller:
    $ref: /schemas/leds/hisilicon,hi6421v600-led.yaml#

  regulators:
    type: object

    additionalProperties: false

    patternProperties:
      '^ldo[0-9]+$':
        type: object

        $ref: /schemas/regulator/regulator.yaml#

        unevaluatedProperties: false

required:
  - compatible
  - reg
  - regulators

additionalProperties: false

examples:
  - |
    #include <dt-bindings/spmi/spmi.h>

    spmi {
        #address-cells = <2>;
        #size-cells = <0>;

        pmic@0 {
            compatible = "hisilicon,hi6421v600-spmi";
            reg = <0 SPMI_USID>;

            #interrupt-cells = <2>;
            interrupt-controller;
            interrupt-parent = <&gpio28>;
            interrupts = <0 0>;

            regulators {
                ldo3 {
                    regulator-boot-on;
                    regulator-max-microvolt = <2000000>;
                    regulator-min-microvolt = <1500000>;
                    regulator-name = "ldo3";
                };

                ldo4 {
                    regulator-boot-on;
                    regulator-max-microvolt = <1900000>;
                    regulator-min-microvolt = <1725000>;
                    regulator-name = "ldo4";
                };

                ldo9 {
                    regulator-boot-on;
                    regulator-max-microvolt = <3300000>;
                    regulator-min-microvolt = <1750000>;
                    regulator-name = "ldo9";
                };

                ldo15 {
                    regulator-always-on;
                    regulator-max-microvolt = <3000000>;
                    regulator-min-microvolt = <1800000>;
                    regulator-name = "ldo15";
                };

                ldo16 {
                    regulator-boot-on;
                    regulator-max-microvolt = <3000000>;
                    regulator-min-microvolt = <1800000>;
                    regulator-name = "ldo16";
                };

                ldo17 {
                    regulator-max-microvolt = <3300000>;
                    regulator-min-microvolt = <2500000>;
                    regulator-name = "ldo17";
                };

                ldo33 {
                    regulator-boot-on;
                    regulator-max-microvolt = <3300000>;
                    regulator-min-microvolt = <2500000>;
                    regulator-name = "ldo33";
                };

                ldo34 {
                    regulator-max-microvolt = <3300000>;
                    regulator-min-microvolt = <2600000>;
                    regulator-name = "ldo34";
                };
            };
        };
    };
```

## Documentation/devicetree/bindings/mfd/hisilicon,hi6421v600-mntn.yaml
```yaml
# SPDX-License-Identifier: (GPL-2.0-only OR BSD-2-Clause)
%YAML 1.2
---
$id: http://devicetree.org/schemas/mfd/hisilicon,hi6421v600-mntn.yaml#
$schema: http://devicetree.org/meta-schemas/core.yaml#

title: Hisilicon Hi6421v600 PMIC OCP/OTMP monitor

maintainers:
  - Wei Xu <xuwei5@hisilicon.com>

description:
  The Hi6421v600 maintenance block monitors PMIC over-current (OCP) and
  over-temperature (OTMP) events. It records the latched state and can
  optionally restart the AP on a fatal event.

properties:
  compatible:
    const: hisilicon,hi6421v600-mntn

  interrupts:
    maxItems: 2

  interrupt-names:
    items:
      - const: otmp
      - const: ocp

  hisilicon,ocp-regs:
    $ref: /schemas/types.yaml#/definitions/uint32-array
    minItems: 8
    maxItems: 8
    description: OCP status registers, one per 8-bit register bank.

  hisilicon,record-regs:
    $ref: /schemas/types.yaml#/definitions/uint32-array
    maxItems: 15
    description: Registers holding the latched fault record.

  hisilicon,otmp-threshold-reg:
    $ref: /schemas/types.yaml#/definitions/uint32-array
    minItems: 3
    maxItems: 3
    description: OTMP threshold field as address, shift and width.

  hisilicon,otmp-threshold-val:
    $ref: /schemas/types.yaml#/definitions/uint32
    description: OTMP threshold field value.

  hisilicon,otmp-hreset-pwrdown-flag:
    type: boolean
    description: Enable PMIC power-down on the OTMP hardware reset.

  hisilicon,otmp-hreset-pwrdown-reg:
    $ref: /schemas/types.yaml#/definitions/uint32-array
    minItems: 3
    maxItems: 3
    description: OTMP power-down field as address, shift and width.

  hisilicon,otmp-hreset-pwrdown-val:
    $ref: /schemas/types.yaml#/definitions/uint32
    description: OTMP power-down field value.

  hisilicon,smpl-ctrl-en:
    $ref: /schemas/types.yaml#/definitions/uint32
    description: Sample control enable value.

  hisilicon,smpl-ctrl-en-reg:
    $ref: /schemas/types.yaml#/definitions/uint32-array
    minItems: 3
    maxItems: 3
    description: Sample control enable field as address, shift and width.

  hisilicon,smpl-ctrl-time:
    $ref: /schemas/types.yaml#/definitions/uint32
    description: Sample control time value.

  hisilicon,smpl-ctrl-time-reg:
    $ref: /schemas/types.yaml#/definitions/uint32-array
    minItems: 3
    maxItems: 3
    description: Sample control time field as address, shift and width.

  hisilicon,ocp-restart:
    type: boolean
    description: Restart the AP after a fatal OCP event.

  hisilicon,otmp-restart:
    type: boolean
    description: Restart the AP after a fatal OTMP event.

required:
  - compatible
  - interrupts
  - interrupt-names
  - hisilicon,record-regs
  - hisilicon,otmp-threshold-reg
  - hisilicon,otmp-threshold-val
  - hisilicon,otmp-hreset-pwrdown-reg
  - hisilicon,otmp-hreset-pwrdown-val
  - hisilicon,smpl-ctrl-en
  - hisilicon,smpl-ctrl-en-reg
  - hisilicon,smpl-ctrl-time
  - hisilicon,smpl-ctrl-time-reg

additionalProperties: false
```

## Documentation/devicetree/bindings/mfd/hisilicon,pmic_ocp_modem.yaml
```yaml
# SPDX-License-Identifier: (GPL-2.0-only OR BSD-2-Clause)
%YAML 1.2
---
$id: http://devicetree.org/schemas/mfd/hisilicon,pmic_ocp_modem.yaml#
$schema: http://devicetree.org/meta-schemas/core.yaml#

title: Hisilicon Balong modem PMIC OCP rails

maintainers:
  - Wei Xu <xuwei5@hisilicon.com>

description:
  Lists the PMIC rails used by the Balong modem. OCP events on these rails
  are forwarded to the modem over ICC before the generic AP PMIC policy is
  applied.

properties:
  compatible:
    const: hisilicon,pmic_ocp_modem

patternProperties:
  "^ldo[0-9]+$":
    type: object

    properties:
      id:
        $ref: /schemas/types.yaml#/definitions/uint32
        description: Modem-internal rail identifier.

    required:
      - id

    additionalProperties: false

required:
  - compatible

additionalProperties: false
```
