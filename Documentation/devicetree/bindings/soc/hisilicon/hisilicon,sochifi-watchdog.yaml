## Documentation/devicetree/bindings/soc/hisilicon/hisilicon,sochifi-watchdog.yaml
```yaml
# SPDX-License-Identifier: (GPL-2.0-only OR BSD-2-Clause)
%YAML 1.2
---
$id: http://devicetree.org/schemas/soc/hisilicon/hisilicon,sochifi-watchdog.yaml#
$schema: http://devicetree.org/meta-schemas/core.yaml#

title: Hisilicon Kirin SoC HiFi watchdog

maintainers:
  - Wei Xu <xuwei5@hisilicon.com>

description:
  The SoC HiFi watchdog interrupt is used by the HiFi DSP reset and error
  reporting path. The watchdog is programmed by firmware; the AP only consumes
  the interrupt.

properties:
  compatible:
    const: hisilicon,sochifi-watchdog

  interrupts:
    maxItems: 1

required:
  - compatible
  - interrupts

additionalProperties: false
```

## Documentation/devicetree/bindings/soc/hisilicon/hisilicon,syscounter.yaml
```yaml
# SPDX-License-Identifier: (GPL-2.0-only OR BSD-2-Clause)
%YAML 1.2
---
$id: http://devicetree.org/schemas/soc/hisilicon/hisilicon,syscounter.yaml#
$schema: http://devicetree.org/meta-schemas/core.yaml#

title: HiSilicon always-on system counter

maintainers:
  - Wei Xu <xuwei5@hisilicon.com>

description: |
  The HiSilicon system counter runs from the always-on clock and keeps
  counting across CPU and system suspend.  Firmware and remote processors
  use it to timestamp events.

properties:
  compatible:
    const: hisilicon,syscounter-driver

  reg:
    maxItems: 1

  clock-rate:
    $ref: /schemas/types.yaml#/definitions/uint64
    description: Counter clock rate in Hz.

  sync-interval:
    $ref: /schemas/types.yaml#/definitions/uint32
    description: Optional periodic resynchronization interval in ms.

required:
  - compatible
  - reg
  - clock-rate

additionalProperties: false
```

## Documentation/devicetree/bindings/sound/hisilicon,codec-controller.yaml
```yaml
# SPDX-License-Identifier: (GPL-2.0-only OR BSD-2-Clause)
%YAML 1.2
---
$id: http://devicetree.org/schemas/sound/hisilicon,codec-controller.yaml#
$schema: http://devicetree.org/meta-schemas/core.yaml#

title: Hisilicon Hi64xx audio codec controller

maintainers:
  - Wei Xu <xuwei5@hisilicon.com>

description:
  The Hi64xx codec controller owns the register access path, master clock and
  supplies for the Hi6403 codec. It also creates the nested Hi64xx interrupt
  controller and the codec device below it.

properties:
  compatible:
    const: hisilicon,codec-controller

  reg:
    maxItems: 1

  interrupts:
    maxItems: 1

  interrupts-extended:
    maxItems: 1

  pinctrl-names:
    items:
      - const: default
      - const: idle

  pinctrl-0: true

  pinctrl-1: true

  clocks:
    maxItems: 1

  clock-names:
    const: clk_pmuaudioclk

  hisilicon,codec-sel:
    $ref: /schemas/types.yaml#/definitions/string
    description: Codec selection string.

  hisilicon,bus-sel:
    enum: [ssi, slimbus]
    description: Register access bus selection.

  hisilicon,reg-8bit-begin-addr:
    $ref: /schemas/types.yaml#/definitions/uint32
    description: Start address of the 8-bit register window.

  hisilicon,reg-8bit-end-addr:
    $ref: /schemas/types.yaml#/definitions/uint32
    description: End address of the 8-bit register window.

  pmu_clkcodec_addr:
    $ref: /schemas/types.yaml#/definitions/uint32
    description: PMIC codec clock control register address.

  pmu_clkcodec_addr_bit:
    $ref: /schemas/types.yaml#/definitions/uint32
    description: PMIC codec clock control register bit.

  slimbusclk_io_driver:
    $ref: /schemas/types.yaml#/definitions/uint32
    description: SLIMbus clock pin drive strength.

  slimbusdata_io_driver:
    $ref: /schemas/types.yaml#/definitions/uint32
    description: SLIMbus data pin drive strength.

  pm_runtime_support:
    type: boolean
    description: Enable runtime PM for the codec controller.

  reg_read_twice:
    type: boolean
    description: Read each register twice on the SSI bus.

  codec_ldo8_set_voltage:
    $ref: /schemas/types.yaml#/definitions/uint32
    description: Set the LDO8 supply to its fixed voltage at probe time.

  hisilicon,ldo8_supply:
    $ref: /schemas/types.yaml#/definitions/uint32
    description: Use the codec LDO8 supply.

  codec-main-supply:
    description: Main codec supply.

  codec-anlg-supply:
    description: Analogue codec supply.

  codec_ldo8-supply:
    description: Codec LDO8 supply.

  "hi64xx-irq":
    $ref: hisilicon,hi64xx-irq.yaml#

required:
  - compatible
  - reg
  - clocks
  - clock-names
  - hisilicon,reg-8bit-begin-addr
  - hisilicon,reg-8bit-end-addr

additionalProperties: false
```

## Documentation/devicetree/bindings/sound/hisilicon,codecssi.yaml
```yaml
# SPDX-License-Identifier: (GPL-2.0-only OR BSD-2-Clause)
%YAML 1.2
---
$id: http://devicetree.org/schemas/sound/hisilicon,codecssi.yaml#
$schema: http://devicetree.org/meta-schemas/core.yaml#

title: Hisilicon Hi64xx SSI register interface

maintainers:
  - Wei Xu <xuwei5@hisilicon.com>

description:
  The codecssi node owns the SSI pin configuration used when the Hi64xx codec
  controller accesses the codec over the SSI bus. It shares the register
  window with the codec controller but only manages the SSI pins.

properties:
  compatible:
    const: hisilicon,codecssi

  reg:
    maxItems: 1

  pinctrl-names:
    items:
      - const: default
      - const: idle

  pinctrl-0: true

  pinctrl-1: true

required:
  - compatible
  - reg

additionalProperties: false
```

## Documentation/devicetree/bindings/sound/hisilicon,hi3xxx-hi6403.yaml
```yaml
# SPDX-License-Identifier: (GPL-2.0-only OR BSD-2-Clause)
%YAML 1.2
---
$id: http://devicetree.org/schemas/sound/hisilicon,hi3xxx-hi6403.yaml#
$schema: http://devicetree.org/meta-schemas/core.yaml#

title: Hisilicon Hi3xxx/Hi6403 audio sound card

maintainers:
  - Wei Xu <xuwei5@hisilicon.com>

description:
  The Hi6403 sound card ties the SLIMbus CPU DAI and the HiFi PCM platform
  together. The card configuration is static in the machine driver and this
  node only describes the presence of the card.

properties:
  compatible:
    const: hisilicon,hi3xxx-hi6403

  model:
    description: User-visible sound card name.

required:
  - compatible

additionalProperties: false
```

## Documentation/devicetree/bindings/sound/hisilicon,hi6210-hifi.yaml
```yaml
# SPDX-License-Identifier: (GPL-2.0-only OR BSD-2-Clause)
%YAML 1.2
---
$id: http://devicetree.org/schemas/sound/hisilicon,hi6210-hifi.yaml#
$schema: http://devicetree.org/meta-schemas/core.yaml#

title: Hisilicon Hi6210/Hi6403 HiFi PCM platform

maintainers:
  - Wei Xu <xuwei5@hisilicon.com>

description:
  The HiFi PCM platform exposes the shared-memory PCM interface between the
  AP and the Kirin HiFi DSP. It is referenced by the Hi6403 sound card as a
  platform component.

properties:
  compatible:
    const: hisilicon,hi6210-hifi

required:
  - compatible

additionalProperties: false
```

## Documentation/devicetree/bindings/sound/hisilicon,hi6403-codec.yaml
```yaml
# SPDX-License-Identifier: (GPL-2.0-only OR BSD-2-Clause)
%YAML 1.2
---
$id: http://devicetree.org/schemas/sound/hisilicon,hi6403-codec.yaml#
$schema: http://devicetree.org/meta-schemas/core.yaml#

title: Hisilicon Hi6403 audio codec

maintainers:
  - Wei Xu <xuwei5@hisilicon.com>

description:
  The Hi6403 codec is a child of the Hi64xx interrupt controller and is
  accessed through the Hi64xx codec controller. The properties below describe
  the board-specific analogue configuration.

properties:
  compatible:
    const: hisilicon,hi6403-codec

  hisilicon,classh_rcv_hp_switch:
    $ref: /schemas/types.yaml#/definitions/uint32
    description: Enable the class-H receiver/headphone switch.

  hisilicon,hp_high_low_change_enable:
    $ref: /schemas/types.yaml#/definitions/uint32
    description: Enable headphone high/low impedance change detection.

  hisilicon,hp_res_detect_enable:
    $ref: /schemas/types.yaml#/definitions/uint32
    description: Enable headphone resistance detection.

  hisilicon,mic_num:
    $ref: /schemas/types.yaml#/definitions/uint32
    description: Number of microphones.

  hisilicon,hs_det:
    $ref: /schemas/types.yaml#/definitions/uint32
    description: Headset detection polarity configuration.

  hisilicon,hs_ctrl:
    $ref: /schemas/types.yaml#/definitions/uint32
    description: Headset detection control register value.

  hisilicon,hs_det_trigger:
    $ref: /schemas/types.yaml#/definitions/uint32
    description: Headset detection comparator mode selector.

  hisilicon,coefficient:
    $ref: /schemas/types.yaml#/definitions/uint32
    description: MBHC SAR ADC full-scale coefficient in millivolts.

  hisilicon,hs_3_pole_min_voltage:
    $ref: /schemas/types.yaml#/definitions/uint32
    description: Minimum voltage for a three-pole headset.

  hisilicon,hs_3_pole_max_voltage:
    $ref: /schemas/types.yaml#/definitions/uint32
    description: Maximum voltage for a three-pole headset.

  hisilicon,hs_4_pole_min_voltage:
    $ref: /schemas/types.yaml#/definitions/uint32
    description: Minimum voltage for a four-pole headset.

  hisilicon,hs_4_pole_max_voltage:
    $ref: /schemas/types.yaml#/definitions/uint32
    description: Maximum voltage for a four-pole headset.

  hisilicon,hs_extern_cable_min_voltage:
    $ref: /schemas/types.yaml#/definitions/uint32
    description: Minimum voltage for an external headset cable.

  hisilicon,hs_extern_cable_max_voltage:
    $ref: /schemas/types.yaml#/definitions/uint32
    description: Maximum voltage for an external headset cable.

  hisilicon,hs_mbhc_vref_reg_value:
    $ref: /schemas/types.yaml#/definitions/uint32
    description: MBHC reference voltage register value.

  hisilicon,hi64xx_irq_reg0:
    $ref: /schemas/types.yaml#/definitions/uint32
    description: Interrupt register 0 initial value.

  hs_detect_extern_cable:
    $ref: /schemas/types.yaml#/definitions/uint32
    description: Enable external cable detection.

  hisilicon,btn_play_min_voltage:
    $ref: /schemas/types.yaml#/definitions/uint32
    description: Minimum voltage for the play/pause button.

  hisilicon,btn_play_max_voltage:
    $ref: /schemas/types.yaml#/definitions/uint32
    description: Maximum voltage for the play/pause button.

  hisilicon,btn_voice_assistant_min_voltage:
    $ref: /schemas/types.yaml#/definitions/uint32
    description: Minimum voltage for the voice assistant button.

  hisilicon,btn_voice_assistant_max_voltage:
    $ref: /schemas/types.yaml#/definitions/uint32
    description: Maximum voltage for the voice assistant button.

  hisilicon,btn_volume_up_min_voltage:
    $ref: /schemas/types.yaml#/definitions/uint32
    description: Minimum voltage for the volume-up button.

  hisilicon,btn_volume_up_max_voltage:
    $ref: /schemas/types.yaml#/definitions/uint32
    description: Maximum voltage for the volume-up button.

  hisilicon,btn_volume_down_min_voltage:
    $ref: /schemas/types.yaml#/definitions/uint32
    description: Minimum voltage for the volume-down button.

  hisilicon,btn_volume_down_max_voltage:
    $ref: /schemas/types.yaml#/definitions/uint32
    description: Maximum voltage for the volume-down button.

  use_stereo_smartpa:
    $ref: /schemas/types.yaml#/definitions/uint32
    description: Configure the smart PA as a stereo device.

  hisilicon,wakeup_hisi_algo_support:
    $ref: /schemas/types.yaml#/definitions/uint32
    description: Enable the Hisilicon wakeup algorithm.

  extern_hs_hifi_ak4376_I2S3:
    $ref: /schemas/types.yaml#/definitions/uint32
    description: Use the external AK4376 headset path on I2S3.

  hsd_cfg_enable:
    $ref: /schemas/types.yaml#/definitions/uint32
    description: Enable the headset detection configuration override.

  hsd_cfg_value:
    $ref: /schemas/types.yaml#/definitions/uint32
    description: Headset detection configuration override value.

  gpio_pd_enable:
    type: boolean
    description: Enable GPIO pull-down during suspend.

  hisilicon,ir_gpio:
    $ref: /schemas/types.yaml#/definitions/phandle-array
    maxItems: 1
    description: Infrared detection GPIO.

  hisilicon,ear_ir_gpio:
    $ref: /schemas/types.yaml#/definitions/phandle-array
    maxItems: 1
    description: Earpiece infrared detection GPIO.

  hisilicon,bt_tri_gpio:
    $ref: /schemas/types.yaml#/definitions/phandle-array
    maxItems: 1
    description: Bluetooth tri-state control GPIO.

  hisilicon,hac_gpio:
    $ref: /schemas/types.yaml#/definitions/uint32
    description: Hearing aid compatibility GPIO number.

  hisilicon,rcv_tdd_gpio:
    $ref: /schemas/types.yaml#/definitions/uint32
    description: Receiver TDD control GPIO number.

  fm_enable:
    $ref: /schemas/types.yaml#/definitions/uint32
    description: Enable the FM audio path.

  hisilicon,pmu_mclk_addr:
    $ref: /schemas/types.yaml#/definitions/uint32
    description: PMIC master clock control register address.

  micbias_modify:
    $ref: /schemas/types.yaml#/definitions/uint32
    description: Enable microphone bias modification.

required:
  - compatible

additionalProperties: false
```

## Documentation/devicetree/bindings/sound/hisilicon,hi64xx-irq.yaml
```yaml
# SPDX-License-Identifier: (GPL-2.0-only OR BSD-2-Clause)
%YAML 1.2
---
$id: http://devicetree.org/schemas/sound/hisilicon,hi64xx-irq.yaml#
$schema: http://devicetree.org/meta-schemas/core.yaml#

title: Hisilicon Hi64xx audio codec interrupt controller

maintainers:
  - Wei Xu <xuwei5@hisilicon.com>

description:
  The Hi64xx interrupt controller is a nested controller behind the Hi64xx
  codec controller. The physical interrupt is requested by the codec
  controller; this node only provides the virtual interrupt domain for the
  codec child devices.

properties:
  compatible:
    const: hisilicon,hi64xx-irq

  interrupt-controller: true

  "#interrupt-cells":
    const: 2

  "hi6403-codec":
    $ref: hisilicon,hi6403-codec.yaml#

required:
  - compatible
  - interrupt-controller
  - "#interrupt-cells"

additionalProperties: false
```

## Documentation/devicetree/bindings/sound/hisilicon,slimbus-dai.yaml
```yaml
# SPDX-License-Identifier: (GPL-2.0-only OR BSD-2-Clause)
%YAML 1.2
---
$id: http://devicetree.org/schemas/sound/hisilicon,slimbus-dai.yaml#
$schema: http://devicetree.org/meta-schemas/core.yaml#

title: Hisilicon SLIMbus CPU DAI

maintainers:
  - Wei Xu <xuwei5@hisilicon.com>

description:
  The SLIMbus CPU DAI is a virtual platform device that connects the
  Hisilicon SLIMbus controller to the ASoC Hi6403 sound card.

properties:
  compatible:
    const: hisilicon,slimbus-dai

required:
  - compatible

additionalProperties: false
```
