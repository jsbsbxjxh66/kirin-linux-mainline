## Documentation/devicetree/bindings/thermal/hisilicon,hi3670-shell-thermal.yaml
```yaml
# SPDX-License-Identifier: (GPL-2.0-only OR BSD-2-Clause)
%YAML 1.2
---
$id: http://devicetree.org/schemas/thermal/hisilicon,hi3670-shell-thermal.yaml#
$schema: http://devicetree.org/meta-schemas/core.yaml#

title: Hisilicon Kirin970 shell and ambient thermal zones

maintainers:
  - Wei Xu <xuwei5@hisilicon.com>

description: |
  The Kirin970 (Hi3670) exposes several board temperature sensors through the
  HKADC and the battery fuel gauge.  This binding describes the aggregation
  nodes that combine those sensors into a shell (device surface) or ambient
  temperature zone.

  A shell zone computes a weighted moving average of its sensors.  An ambient
  zone reports the minimum sensor temperature minus a bias.  Sensor voltages
  are converted to temperature with the NTC tables built into the driver.

properties:
  compatible:
    enum:
      - hisilicon,hi3670-shell-temp
      - hisilicon,hi3670-ambient-temp

  interval:
    description:
      Polling interval.  Shell zones use milliseconds, ambient zones use
      seconds.
    $ref: /schemas/types.yaml#/definitions/uint32

  bias:
    description:
      Temperature offset.  Shell zones use millidegrees Celsius, ambient
      zones use degrees Celsius.
    $ref: /schemas/types.yaml#/definitions/uint32

  count:
    description: Number of samples in the moving average.
    $ref: /schemas/types.yaml#/definitions/uint32
    minimum: 1

  shell-temp-step:
    description: Maximum temperature change per interval, in millidegrees Celsius.
    $ref: /schemas/types.yaml#/definitions/uint32

  shell-temp-step-range:
    description: Temperature delta above which the step limit is applied.
    $ref: /schemas/types.yaml#/definitions/uint32

  io-channels:
    description: HKADC channels used by the zone.  The battery sensor is read
      through the power supply interface instead.
    minItems: 1
    maxItems: 4

  io-channel-names:
    oneOf:
      - items:
          - const: system_h
      - items:
          - const: system_h
          - const: charger
      - items:
          - const: system_h
          - const: charger
          - const: pa_0
      - items:
          - const: system_h
          - const: charger
          - const: pa_0
          - const: dcxo0

  sensors:
    type: object
    additionalProperties: false
    patternProperties:
      "^sensor[0-9]+$":
        type: object
        additionalProperties: false
        properties:
          type:
            description: Sensor name or power supply property source.
            enum:
              - system_h
              - charger
              - pa_0
              - dcxo0
              - Battery
          coef:
            description: Per-sample weights for a shell zone.
            $ref: /schemas/types.yaml#/definitions/uint32-array
        required:
          - type

required:
  - compatible
  - interval
  - sensors

additionalProperties: false

examples:
  - |
    hkadc: adc {
        #io-channel-cells = <1>;
    };

    shell-frame {
        compatible = "hisilicon,hi3670-shell-temp";
        interval = <5000>;
        bias = <500>;
        count = <6>;
        shell-temp-step = <200>;
        shell-temp-step-range = <400>;
        io-channels = <&hkadc 7>, <&hkadc 5>, <&hkadc 4>, <&hkadc 15>;
        io-channel-names = "system_h", "charger", "pa_0", "dcxo0";

        sensors {
            sensor0 {
                type = "system_h";
                coef = <(-9643) (-4992) (-2884) (-2948) (-1338) (-470)>;
            };
            sensor1 {
                type = "Battery";
                coef = <20343 3543 9720 5217 3527 12166>;
            };
        };
    };

    ambient {
        compatible = "hisilicon,hi3670-ambient-temp";
        interval = <900>;
        bias = <1>;
        io-channels = <&hkadc 7>, <&hkadc 5>, <&hkadc 4>, <&hkadc 15>;
        io-channel-names = "system_h", "charger", "pa_0", "dcxo0";

        sensors {
            sensor0 {
                type = "system_h";
            };
            sensor1 {
                type = "Battery";
            };
        };
    };
...
```

## Documentation/devicetree/bindings/thermal/hisilicon,hi3670-tsensor.yaml
```yaml
# SPDX-License-Identifier: (GPL-2.0-only OR BSD-2-Clause)
%YAML 1.2
---
$id: http://devicetree.org/schemas/thermal/hisilicon,hi3670-tsensor.yaml#
$schema: http://devicetree.org/meta-schemas/core.yaml#

title: Hisilicon Kirin970 TSENSOR

maintainers:
  - The Kirin970 mainline porting project

description: |
  The TSENSOR block on the Hisilicon Kirin970 (Hi3670) SoC provides
  several on-die temperature sensors.  Its registers are only accessible
  from secure firmware, so the operating system reads the sensors through
  an SMC call.

  The sensors are identified by an index, which is passed as the second
  cell of the "thermal-sensors" property.  Indices 0, 1, 2 and 3 map to
  the little cluster, the big cluster, the GPU and the modem respectively.

properties:
  compatible:
    const: hisilicon,hi3670-tsensor

  "#thermal-sensor-cells":
    const: 1

  hisilicon,adc-start-value:
    description: ADC code corresponding to the minimum temperature (-40 C).
    $ref: /schemas/types.yaml#/definitions/uint32

  hisilicon,adc-end-value:
    description: ADC code corresponding to the maximum temperature (125 C).
    $ref: /schemas/types.yaml#/definitions/uint32

required:
  - compatible
  - "#thermal-sensor-cells"
  - hisilicon,adc-start-value
  - hisilicon,adc-end-value

additionalProperties: false

examples:
  - |
    tsens: thermal-sensor {
        compatible = "hisilicon,hi3670-tsensor";
        #thermal-sensor-cells = <1>;
        hisilicon,adc-start-value = <0x9a>;
        hisilicon,adc-end-value = <0x398>;
    };

    thermal-zones {
        cpu0-thermal {
            polling-delay-passive = <250>;
            polling-delay = <1000>;
            thermal-sensors = <&tsens 0>;

            trips {
                cpu0-alert {
                    temperature = <85000>;
                    hysteresis = <2000>;
                    type = "hot";
                };

                cpu0-crit {
                    temperature = <105000>;
                    hysteresis = <2000>;
                    type = "critical";
                };
            };
        };
    };
...
```

## Documentation/devicetree/bindings/usb/ti,tusb422.yaml
```yaml
# SPDX-License-Identifier: (GPL-2.0 OR BSD-2-Clause)
%YAML 1.2
---
$id: http://devicetree.org/schemas/usb/ti,tusb422.yaml#
$schema: http://devicetree.org/meta-schemas/core.yaml#

title: Texas Instruments TUSB422 Type-C Port Controller

maintainers:
  - opencode <opencode@localhost>

description: |
  The TUSB422 is a TCPCI-compliant Type-C port controller with USB Power
  Delivery support.  It is connected over I2C and raises an active-low alert
  interrupt when the Type-C or PD state changes.

properties:
  compatible:
    const: ti,tusb422

  reg:
    maxItems: 1

  interrupts:
    maxItems: 1

  connector:
    type: object
    $ref: /schemas/connector/usb-connector.yaml#
    unevaluatedProperties: false

required:
  - compatible
  - reg
  - interrupts
  - connector

additionalProperties: false

examples:
  - |
    #include <dt-bindings/interrupt-controller/arm-gic.h>
    #include <dt-bindings/usb/pd.h>

    i2c {
        #address-cells = <1>;
        #size-cells = <0>;

        tusb422@20 {
            compatible = "ti,tusb422";
            reg = <0x20>;
            interrupt-parent = <&gpio27>;
            interrupts = <5 IRQ_TYPE_LEVEL_LOW>;

            connector {
                compatible = "usb-c-connector";
                label = "USB-C";
                power-role = "dual";
                data-role = "dual";
                try-power-role = "sink";
                typec-power-opmode = "default";
            };
        };
    };
```

## drivers/clk/hisilicon/Kconfig
```kconfig
# SPDX-License-Identifier: GPL-2.0-only
config COMMON_CLK_HI3516CV300
	tristate "HI3516CV300 Clock Driver"
	depends on ARCH_HISI || COMPILE_TEST
	select RESET_HISI
	default ARCH_HISI
	help
	  Build the clock driver for hi3516cv300.

config COMMON_CLK_HI3519
	tristate "Hi3519 Clock Driver"
	depends on ARCH_HISI || COMPILE_TEST
	select RESET_HISI
	default ARCH_HISI
	help
	  Build the clock driver for hi3519.

config COMMON_CLK_HI3559A
	bool "Hi3559A Clock Driver"
	depends on ARCH_HISI || COMPILE_TEST
	select RESET_HISI
	default ARCH_HISI
	help
	  Build the clock driver for hi3559a.

config COMMON_CLK_HI3660
	bool "Hi3660 Clock Driver"
	depends on ARCH_HISI || COMPILE_TEST
	default ARCH_HISI
	help
	  Build the clock driver for hi3660.

config CLK_HI6421V600
	tristate "HiSilicon Hi6421v600 PMIC clock gate"
	depends on MFD_HI6421_SPMI
	depends on COMMON_CLK_HI3670
	help
	  Support the PMU audio clock gate in the Hi6421v600 PMIC.  This is
	  the MCLK supplied to the Hi6403 codec controller.

config COMMON_CLK_HI3670
	bool "Hi3670 Clock Driver"
	depends on ARCH_HISI || COMPILE_TEST
	default ARCH_HISI
	help
	  Build the clock driver for hi3670.

config COMMON_CLK_HI3798CV200
	tristate "Hi3798CV200 Clock Driver"
	depends on ARCH_HISI || COMPILE_TEST
	select RESET_HISI
	default ARCH_HISI
	help
	  Build the clock driver for hi3798cv200.

config COMMON_CLK_HI6220
	bool "Hi6220 Clock Driver"
	depends on ARCH_HISI || COMPILE_TEST
	default ARCH_HISI
	help
	  Build the Hisilicon Hi6220 clock driver based on the common clock framework.

config RESET_HISI
	bool "HiSilicon Reset Controller Driver"
	depends on ARCH_HISI || COMPILE_TEST
	select RESET_CONTROLLER
	help
	  Build reset controller driver for HiSilicon device chipsets.

config STUB_CLK_HI6220
	bool "Hi6220 Stub Clock Driver" if EXPERT
	depends on (COMMON_CLK_HI6220 || COMPILE_TEST)
	depends on MAILBOX
	default COMMON_CLK_HI6220
	help
	  Build the Hisilicon Hi6220 stub clock driver.

config STUB_CLK_HI3660
	bool "Hi3660 Stub Clock Driver" if EXPERT
	depends on (COMMON_CLK_HI3660 || COMPILE_TEST)
	depends on MAILBOX
	default COMMON_CLK_HI3660
	help
	  Build the Hisilicon Hi3660 stub clock driver.

config STUB_CLK_HI3670
	bool "Hi3670 Stub Clock Driver" if EXPERT
	depends on (COMMON_CLK_HI3670 || COMPILE_TEST)
	depends on MAILBOX
	default COMMON_CLK_HI3670
	help
	  Build the Hisilicon Hi3670 stub clock driver.  CPU cluster rates are
	  negotiated with the LPM3 firmware over the mailbox.
```

## drivers/firmware/hisilicon/Kconfig
```kconfig
# SPDX-License-Identifier: GPL-2.0-only

config LOAD_IMAGE
	bool "Hisilicon secure image loader"
	depends on TZDRIVER
	help
	  This driver loads and authenticates secure images for the
	  Hisilicon modem and HIFI cores through the secure monitor, and
	  provides the core-reset notification used by the modem driver.
```

## drivers/gnss/hisilicon/Kconfig
```kconfig
# SPDX-License-Identifier: GPL-2.0-only

source "drivers/gnss/hisilicon/hw_gps/Kconfig"
```

## drivers/gpu/drm/hisilicon/hisi_dpe/Kconfig
```kconfig
# SPDX-License-Identifier: GPL-2.0-only

config DRM_HISI_DPE
	tristate "DRM support for HiSilicon Hi3670 DPE"
	depends on DRM && ARM64
	depends on OF
	select DRM_CLIENT_SELECTION
	select DRM_KMS_HELPER
	select DRM_GEM_DMA_HELPER
	select FB_DMAMEM_HELPERS if DRM_FBDEV_EMULATION
	help
	  Choose this option if you have a HiSilicon Hi3670 (Kirin 970)
	  SoC with DPE (Display Processing Engine) display controller.
	  This driver provides DRM/KMS support for the primary display
	  output via MIPI DSI.

	  If M is selected, the module will be called hisi_dpe.

config DRM_HISI_DSI
	tristate "DRM support for HiSilicon Hi3670 DSI Host"
	depends on DRM && ARM64
	depends on OF
	select DRM_KMS_HELPER
	select DRM_MIPI_DSI
	select DRM_PANEL_BRIDGE
	help
	  Choose this option if you have a HiSilicon Hi3670 (Kirin 970)
	  SoC with DesignWare DSI Host Controller v410.
	  This driver provides MIPI DSI host support.

	  If M is selected, the module will be called hisi_dpe_dsi.

config DRM_PANEL_HISI_FT8719
	tristate "HISI BOE FT8719 1080x2340 MIPI DSI panel"
	depends on DRM && ARM64
	depends on OF
	select DRM_PANEL
	help
	  Say Y here if you want to enable support for the BOE FT8719
	  1080x2340 MIPI DSI panel found in the Honor Play (COR-AL00).

	  The symbol is named DRM_PANEL_HISI_FT8719 and the compatible is
	  "hisi,ft8719" to keep it separate from upstream's
	  DRM_PANEL_EBBG_FT8719 / "ebbg,ft8719".

	  If M is selected, the module will be called panel-hisi-ft8719.

config DRM_PANEL_HISI_TD4320
	tristate "HISI BOE TD4320 1080x2340 MIPI DSI panel"
	depends on DRM && ARM64
	depends on OF && DRM_PANEL
	help
	  Say Y here if you want to enable support for the BOE TD4320
	  1080x2340 MIPI DSI panel. This is the panel the COR-AL00 actually
	  ships with - sys-fdt.dts's huawei,lcd_panel node reports
	  lcd_panel_type = "boe_td4320_6p3_1080p_video" - and it shares the
	  glass with the FT8719 variant but differs in its porches, its reset
	  timing and its init sequence.

	  The symbol is named DRM_PANEL_HISI_TD4320 and the compatible is
	  "hisi,td4320" because upstream's DRM_PANEL_BOE_TD4320 /
	  "boe,td4320" already targets the Xiaomi Redmi Note 7 with the same
	  glass wired for 4 data lanes and video burst. Sharing either name
	  would let both drivers fight over one DT node.

	  If M is selected, the module will be called panel-hisi-td4320.
```

## drivers/iommu/hisilicon/Kconfig
```kconfig
# SPDX-License-Identifier: GPL-2.0-only
config HISI_SMMU_LPAE
	bool "Hisilicon LPAE SMMU page-table manager"
	depends on ARM64 && (ARCH_HISI || COMPILE_TEST)
	select IOMMU_API
	help
	  Support for the shared LPAE SMMU page tables used by the media
	  subsystems (ISP, IVP, JPEG) on Hisilicon Kirin SoCs.

	  The secure firmware and the consumer drivers program the SMMU
	  hardware; this driver only manages the three-level page tables.

	  Say Y here if you want to use the SMMU on a Kirin 970 device.

	  If unsure, say N.
```

## drivers/media/platform/hisilicon/Kconfig
```kconfig
# SPDX-License-Identifier: GPL-2.0-only

comment "Hisilicon media platform drivers"

source "drivers/media/platform/hisilicon/jpu/Kconfig"
source "drivers/media/platform/hisilicon/venc/Kconfig"
```

## drivers/media/platform/hisilicon/jpu/Kconfig
```kconfig
# SPDX-License-Identifier: GPL-2.0
config VIDEO_HISI_JPU
	tristate "Hisilicon JPEG processing unit (JPU) support"
	depends on ARCH_HISI
	depends on IOMMU_SUPPORT
	select IOMMU_IO_PGTABLE_LPAE
	select DMA_SHARED_BUFFER
	help
	  The decode device provides decode function for JPEG.
```

## drivers/media/platform/hisilicon/venc/Kconfig
```kconfig
# SPDX-License-Identifier: GPL-2.0-only

config VIDEO_HISI_VENC
	tristate "Hisilicon Kirin 970 VENC support"
	depends on ARCH_HISI
	depends on OF
	depends on IOMMU_SUPPORT
	select IOMMU_IO_PGTABLE_LPAE
	select DMA_SHARED_BUFFER
	help
	  Say Y here to enable the HiSilicon VEDU video encoder found on
	  Kirin 970 (Hi3670).  The driver exposes the vendor OMX interface
	  through /dev/hi_venc and uses the encoder's built-in SMMU with
	  generic ARM LPAE page tables.
```

## drivers/misc/hisilicon/Kconfig
```kconfig
# SPDX-License-Identifier: GPL-2.0-only

source "drivers/misc/hisilicon/fingerprint/Kconfig"
source "drivers/misc/hisilicon/ipu/Kconfig"
source "drivers/misc/hisilicon/ivp/Kconfig"
```

## drivers/misc/hisilicon/ipu/Kconfig
```kconfig
# SPDX-License-Identifier: GPL-2.0-only

config HISI_ICS_IPU
	bool "Hisilicon Cambricon IPU support"
	depends on ARCH_HISI || COMPILE_TEST
	depends on IOMMU_API
	depends on ARM64
	select DMA_SHARED_BUFFER
	help
	  Support for the Cambricon IPU (NPU) found on Kirin 970.
	  This provides the character device, clock/power, SMMU and
	  maintenance interfaces. Firmware and userspace runtime are
	  still required for actual inference.
```
