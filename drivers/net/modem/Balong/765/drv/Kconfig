## drivers/tee/hisilicon/Kconfig
```kconfig
menu "TEE OS"

config SECURE_EXTENSION
	bool "security extension support"
	default n
	help
	  Include Security Extension.

config  TZDRIVER
	tristate "Secure Execution Communicator driver"
	default n
	depends on SECURE_EXTENSION
	help
	  Provides a communication interface between userspace and
	  TrustZone Operating Environment.

config TEELOG
	tristate "Secure Execution Log driver"
	default n
	depends on TZDRIVER
	help
	  TEEOS log

config TEE_TUI
	tristate "Trusted user interface driver"
	default n
	depends on TZDRIVER && BROKEN
	help
	  Trusted user interface diver

	  Not usable on mainline: the TUI buffer management is built on the
	  vendor ION allocator, which does not exist in this tree.

config TEE_TUI_ION
	tristate "Trusted user interface driver for ION"
	default n
	depends on TZDRIVER && BROKEN
	help
	  Trusted user interface diver (requires ION, unavailable here)

config TEE_TUI_ION_ADD
	tristate "Trusted user interface driver for add ION memory"
	default n
	depends on TZDRIVER && BROKEN
	help
	  Trusted user interface diver (requires ION, unavailable here)

config TEE_TUI_FP
	tristate "Trusted user interface driver for FP"
	default n
	depends on TZDRIVER && BROKEN
	help
	  Trusted user interface diver (requires ION, unavailable here)

config TEE_CPU_MIGRATION
	tristate "TEE cpu core migration"
	default n
	depends on TZDRIVER
	help
	  TEE cpu core migration

config HISI_SPI_SMC
	bool "hisi spi smc"
	default n

config HISI_SPI1_SMC
	bool "hisi spi1 smc"
	default n

config SECS_POWER_CTRL
	bool "secs power ctrl"
	default n

config HISI_MMC_SECURE_RPMB
	bool "Hisilicon secure RPMB proxy"
	depends on TZDRIVER
	depends on RPMB
	default n
	help
	  Route RPMB frames requested by the secure OS to the mainline RPMB
	  subsystem.  Both eMMC and UFS RPMB partitions are supported through
	  their generic rpmb_dev interfaces.

config TEE_CFC
	bool "Enable CFC to protect TEE"
	select PID_IN_CONTEXTIDR
	select TEE_CFC_ABI
	depends on BROKEN
	depends on ((!CORESIGHT) && (!CORESIGHT_SOURCE_ETM4X) && (!CORESIGHT_LINK_AND_SINK_TMC) && (!CONFIG_CORESIGHT_SINK_TPIU) && (!CONFIG_CORESIGHT_SINK_ETBV10) && (!CONFIG_CORESIGHT_LINKS_AND_SINKS) && (!CONFIG_HISI_CORESIGHT_TRACE))
	default n
	help
	  Code in TZDriver in a continuous text section and use smc call
	  to let TEEOS protect these code using DMSS. CoreSight based control
	  flow certification should be applied.

	  Not usable on mainline: cfc_coresight.c is written against the
	  pre-5.10 CoreSight platform-data API (of_get_coresight_platform_data
	  and struct coresight_platform_data), which no longer exists.

config TEE_CFC_ABI
	bool "Enable CFC ABI"
	default n
	help
	  TC_NS_SMC_CMD depends on TEEOS. If TEEOS selects FEATURE_CFC,
	  TEE_CFC_ABI should be selected even if TEE_CFC is off.

config TZDRIVER_CODE_ALIGN_SHIFT
	int "Alignment of code in tzdriver"
	range 16 19
	default 19
	depends on TEE_CFC
	help
	  Code of TZDriver should be aligned due to DMSS limitation.
	  There are two DMSS. In Hi3660, we need align tzdriver in
	  512kB physical memory boundry. In Hi3670 the limitation
	  reduced to 64kB.

config HISI_SECBOOT_IMG
    bool "tzdriver split secboot img into modem and ap"
    default n
    help
      Macro defined for splitting modem and ap img


endmenu
```

## drivers/thermal/hisilicon/Kconfig
```kconfig
# SPDX-License-Identifier: GPL-2.0-only

source "drivers/thermal/hisilicon/power_thermalzone/Kconfig"
```

## sound/soc/hisilicon/Kconfig
```kconfig
# SPDX-License-Identifier: GPL-2.0-only
menu "Hisilicon"

config SND_I2S_HI6210_I2S
	tristate "Hisilicon I2S controller"
	select SND_SOC_GENERIC_DMAENGINE_PCM
	help
	  Hisilicon I2S

config SND_SOC_HISILICON_SLIMBUS_DAI
	tristate "HiSilicon SLIMbus CPU DAI"
	depends on HISILICON_PLATFORM_SLIMBUS
	help
	  Say Y to enable the HiSilicon SLIMbus CPU DAI.

config SND_SOC_PCM_HI6210
	tristate "HiSilicon Hi6210 HIFI PCM platform"
	depends on HIFI_MAILBOX
	depends on HIFI_DSP_ONE_TRACK
	select SND_HWDEP
	help
	  Say Y to enable the HiSilicon HIFI PCM platform used by the
	  Hi3660/Hi6403 sound card.

config SND_SOC_HI3660_HI6403
	tristate "Hi3660-Hi6403 sound support"
	depends on SND_SOC_HI6403
	select SND_SOC_HISILICON_SLIMBUS_DAI
	select SND_SOC_PCM_HI6210
	help
	  Say Y to enable sound support for Hi3660 with the Hi6403 codec.

source "sound/soc/hisilicon/hi64xx/Kconfig"
source "sound/soc/hisilicon/hi64xx_dsp/Kconfig"
source "sound/soc/hisilicon/hifi_dsp/Kconfig"
source "sound/soc/hisilicon/hifi_mailbox/Kconfig"
source "sound/soc/hisilicon/slimbus/Kconfig"
source "sound/soc/hisilicon/soundtrigger/Kconfig"

endmenu
```

## sound/soc/hisilicon/hifi_mailbox/Kconfig
```kconfig
source "sound/soc/hisilicon/hifi_mailbox/mailbox/Kconfig"
source "sound/soc/hisilicon/hifi_mailbox/ipcm/Kconfig"
```
