## drivers/net/modem/Balong/765/drv/Kconfig
```kconfig
menu "Modem Drivers"

source "drivers/net/modem/Balong/765/drv/ipc/Kconfig"
source "drivers/net/modem/Balong/765/drv/icc/Kconfig"
source "drivers/net/modem/Balong/765/drv/sec_call/Kconfig"
source "drivers/net/modem/Balong/765/drv/balong_timer/Kconfig"
source "drivers/net/modem/Balong/765/drv/reset/Kconfig"
source "drivers/net/modem/Balong/765/drv/rfile/Kconfig"
source "drivers/net/modem/Balong/765/drv/nvim/Kconfig"
source "drivers/net/modem/Balong/765/drv/s_memory/Kconfig"
source "drivers/net/modem/Balong/765/drv/hwadp/Kconfig"
source "drivers/net/modem/Balong/765/drv/onoff/Kconfig"
source "drivers/net/modem/Balong/765/drv/efuse/Kconfig"
source "drivers/net/modem/Balong/765/drv/loadm/Kconfig"
source "drivers/net/modem/Balong/765/drv/udi/Kconfig"
source "drivers/net/modem/Balong/765/drv/sysctrl/Kconfig"
source "drivers/net/modem/Balong/765/drv/mem/Kconfig"
source "drivers/net/modem/Balong/765/drv/sync/Kconfig"
source "drivers/net/modem/Balong/765/drv/sc/Kconfig"
source "drivers/net/modem/Balong/765/drv/ipf/Kconfig"
source "drivers/net/modem/Balong/765/drv/psam/Kconfig"
source "drivers/net/modem/Balong/765/drv/espe/Kconfig"
source "drivers/net/modem/Balong/765/drv/n_ipf/Kconfig"
source "drivers/net/modem/Balong/765/drv/n_psam/Kconfig"
source "drivers/net/modem/Balong/765/drv/dump/Kconfig"
source "drivers/net/modem/Balong/765/drv/pm_om/Kconfig"
source "drivers/net/modem/Balong/765/drv/ocp/Kconfig"
source "drivers/net/modem/Balong/765/drv/sim_hotplug/Kconfig"
source "drivers/net/modem/Balong/765/drv/bbp/Kconfig"
source "drivers/net/modem/Balong/765/drv/net_helper/Kconfig"
endmenu
```

## drivers/net/modem/Balong/765/drv/ocp/Kconfig
```kconfig
config PMIC_OCP
	bool "Balong PMIC OCP forwarding"
	depends on HI6421V600_MNTN
	default n
	help
	  Forward PMIC OCP events for modem rails over ICC so that the modem
	  can log and recover from a rail fault before the AP applies its
	  generic OCP policy.
```

## drivers/net/modem/Kconfig
```kconfig
# SPDX-License-Identifier: GPL-2.0-only
#
# Modem drivers
#

source "drivers/net/modem/Balong/765/Kconfig"
```

## drivers/net/wireless/hisi/Kconfig
```kconfig
# SPDX-License-Identifier: GPL-2.0
#
# Hisilicon Hi110x wireless connectivity combo (WLAN + BFGX transport)
#

menuconfig HISI_CONNECTIVITY
	bool "Hisilicon Hi110x wireless connectivity"
	depends on CFG80211
	depends on WIRELESS
	depends on MMC
	help
	  Support for the Hisilicon Hi1102/Hi1102A/Hi1103 wireless
	  connectivity combo chips.  This provides the SDIO/PCIe WLAN
	  driver and the shared BFGX transport used by the companion
	  Bluetooth HCI driver (CONFIG_BT_HI1102).

	  The three chip variants expose the same symbol names and can
	  therefore only be built one at a time.

if HISI_CONNECTIVITY

choice
	prompt "Connectivity chip variant"
	default HISI_CONNECTIVITY_HI1102
	help
	  Select the connectivity chip mounted on the board.  Note the chip
	  and the driver stack are independent: the Hi1102 chip (and Hi1102A)
	  are driven by the "1102a" driver stack (drivers/net/wireless/hisi/
	  hi1102a/), which is the only stack ported to this kernel.  The
	  runtime chip identity is taken from DT (hi110x,subchip_type), not
	  from this choice.

config HISI_CONNECTIVITY_HI1102
	bool "Hi1102"
	help
	  Kirin 970 generation Hi1102 combo chip (WLAN + BT/FM/GNSS).  Builds
	  the ported 1102a driver stack, which loads Hi1102 firmware from
	  /vendor/firmware at runtime.

config HISI_CONNECTIVITY_HI1102A
	bool "Hi1102A"
	help
	  Same driver stack as Hi1102 (the 1102a stack); kept as an explicit
	  alias for boards whose OTP identifies the chip as Hi1102A.

config HISI_CONNECTIVITY_HI1103
	bool "Hi1103"
	help
	  Kirin 980 generation chip.  The hi1103/ tree is NOT ported to this
	  kernel yet; selecting it will fail to build.

endchoice

config HISI_CONNECTIVITY_HI1102_LEGACY
	bool "Hi1102 legacy stack (unported)"
	depends on !HISI_CONNECTIVITY_HI1102 && !HISI_CONNECTIVITY_HI1102A
	default n
	help
	  Vendor drivers/connectivity/hisi/ mirror (drivers/net/wireless/
	  hisi/hi1102/, _PRE_PRODUCT_VERSION=1102).  NOT ported to this
	  kernel: it still uses APIs removed from mainline (wireless ext,
	  old firmware loader) and will not compile.  Enable only to work
	  on porting it.

config HI1102_PLAT_HW_CHR
	bool "Hi110x hardware CHR logging"
	default y
	help
	  Log connectivity hardware channel (CHR) events through the
	  platform driver.

config HI110X_PLAT_BB
	bool "Hi110x baseband monitoring"
	default n
	help
	  Include the BFGX baseband monitor.  Only useful for bring-up
	  and firmware debugging.

config HI110X_SDIO_STD_CARD_SUPPORT
	bool "Hi110x standard SDIO card support"
	default n
	help
	  Use the standard SDIO card initialisation path instead of the
	  vendor non-standard one.

config HI110X_GPS_REFCLK
	bool "Hi110x GNSS reference clock"
	default y
	help
	  Route the modem reference clock to the GNSS block.

choice
	prompt "GNSS reference clock source"
	depends on HI110X_GPS_REFCLK
	default HI110X_GPS_REFCLK_SRC_3
	help
	  Select which modem clock output feeds the GNSS reference
	  clock input on this platform.

config HI110X_GPS_REFCLK_SRC_1
	bool "Modem GPS one clock"

config HI110X_GPS_REFCLK_SRC_2
	bool "Modem GPS two clock"

config HI110X_GPS_REFCLK_SRC_3
	bool "Modem GPS three clock"

endchoice

config HI110X_GPS_REFCLK_INTERFACE
	bool "Hi110x GNSS reference clock interface"
	depends on HI110X_GPS_REFCLK
	default n
	help
	  Export the GNSS reference clock through the hwgps interface.

config HI110X_GPS_SYNC
	bool "Hi110x GNSS time synchronisation"
	depends on HI110X_GPS_REFCLK
	default y
	help
	  Synchronise the GNSS timebase with the modem reference clock.

config ARCH_KIRIN_PCIE
	bool "Hi110x PCIe transport"
	depends on PCI
	default n
	help
	  Use PCIe instead of SDIO to talk to the connectivity chip.

endif # HISI_CONNECTIVITY
```

## drivers/power/hisi/Kconfig
```kconfig
config POWER_HISI
	bool "Hisilicon power management drivers"
	depends on ARCH_HISI
	default n
	help
	  Support for the Hisilicon/Kirin battery, coulomb counter and
	  charger drivers used on the Kirin 970 platform.

if POWER_HISI

config HISI_BATTERY_DATA
	bool "hisi battery data"
	default n

config HISI_BCI_BATTERY
        bool "hisi bci battery"
        default n

source "drivers/power/hisi/charger/Kconfig"
source "drivers/power/hisi/coul/Kconfig"
source "drivers/power/hisi/soh/Kconfig"
source "drivers/power/hisi/asw/Kconfig"
source "drivers/power/hisi/huawei/Kconfig"
endif # POWER_HISI
```

## drivers/power/hisi/huawei/Kconfig
```kconfig
# SPDX-License-Identifier: GPL-2.0-only

source "drivers/power/hisi/huawei/power_mesg/Kconfig"
source "drivers/power/hisi/huawei/charger/Kconfig"
source "drivers/power/hisi/huawei/battery/Kconfig"
```

## drivers/power/hisi/huawei/battery/Kconfig
```kconfig
source "drivers/power/hisi/huawei/battery/battery_ct/Kconfig"
source "drivers/power/hisi/huawei/battery/battery_voltage/Kconfig"
source "drivers/power/hisi/huawei/battery/battery_temp/Kconfig"
source "drivers/power/hisi/huawei/battery/battery_type_identify/Kconfig"
```

## drivers/power/hisi/huawei/battery/battery_ct/Kconfig
```kconfig
menu "Battery certification support"

menuconfig HUAWEI_BATTERY_INFORMATION
	bool
	prompt "Certificate battery by information of IC."
	default n

source "drivers/power/hisi/huawei/battery/battery_ct/MAXIM/Kconfig"

endmenu
```

## drivers/power/hisi/huawei/charger/Kconfig
```kconfig
source "drivers/power/hisi/huawei/charger/charger_ap/Kconfig"
source "drivers/power/hisi/huawei/charger/charger_sensorhub/Kconfig"
source "drivers/power/hisi/huawei/charger/charger_protocol/Kconfig"

config HUAWEI_CHARGER
	bool "huawei charger"
	default n
```

## drivers/remoteproc/hisilicon/Kconfig
```kconfig
# SPDX-License-Identifier: GPL-2.0-only
config HISI_ISP_REMOTEPROC
	tristate "Hisilicon ISP remote processor"
	depends on ARCH_HISI || COMPILE_TEST
	depends on REMOTEPROC
	depends on OF
	depends on IOMMU_SUPPORT
	select IOMMU_IO_PGTABLE_LPAE
	help
	  Say y here to support the Hisilicon Hi3670 ISP remote processor.

	  This is a mainline-style remoteproc driver.  It registers the ISP
	  Cortex-A7 with the remoteproc framework, maps the ISP register
	  windows, owns a local LPAE page table for the ISP SMMU and can load
	  an ELF firmware into on-demand mapped IOVA.

	  Optional clocks and regulators, the CRG remap bit and the ISP SMMU
	  registers are wired up.  The DT clock provider/supply wiring, secure
	  memory, shared memory and the mailbox/rpmsg transport are not ported
	  yet, so the remote processor cannot be booted.  Keep the DT node
	  disabled until those pieces land.
```

## drivers/soc/hisilicon/Kconfig
```kconfig
# SPDX-License-Identifier: GPL-2.0-only

menu "Hisilicon SoC drivers"
	depends on ARCH_HISI || COMPILE_TEST

config KUNPENG_HCCS
	tristate "HCCS driver on Kunpeng SoC"
	depends on ACPI
	depends on PCC
	depends on ARM64 || COMPILE_TEST
	help
	  The Huawei Cache Coherence System (HCCS) is a multi-chip
	  interconnection bus protocol.
	  The performance of application may be affected if some HCCS
	  ports are not in full lane status, have a large number of CRC
	  errors and so on. This may support for reducing system power
	  consumption if there are HCCS ports supported low power feature
	  on platform.

	  Say M here if you want to include support for querying the
	  health status and port information of HCCS, or reducing system
	  power consumption on Kunpeng SoC.

config HISI_ACCURATE_DELAY
	bool "Hisilicon accurate delay library"
	default n
	help
	  Say yes here to use the Hisilicon accurate delay helper.  The
	  implementation lives in lib/hisilicon and is used by the
	  platform drivers that need a calibrated busy-wait.

config HISI_CMDLINE_PARSE
	bool "Hisilicon boot command line parser"
	default n
	help
	  Say Y here to parse the Hisilicon-specific boot command line
	  fragments and expose the getters used by NVE and the power
	  drivers.

config HISI_SECS_CTRL
	bool "Hisilicon SECS power controller"
	default n
	help
	  Say yes here to support the HISI SECS secure power rail used by
	  the secure monitor call helpers.

config SECURE_TEST
	bool "Secure Test"
	default n
	depends on HISI_SECS_CTRL
	help
	  Secure Test: in adb shell, use the following commands to test:
	  "echo 2 > proc/secure-test" to test secure_timer_SR
	  "echo mem > sys/power/state" into SR
	  "echo 3 > proc/secure-test" to test aocc_key_SR

config DRMDRIVER
	tristate "Hisilicon DRM module driver"
	default n
	help
	  Provides the secure configuration channel between the kernel
	  and BL31, plus the DRM module ioctl interface.

config HISI_HW_VOTE
	bool "Hisilicon hardware frequency vote"
	default n
	help
	  Say Y here to enable the HiSilicon hardware frequency vote
	  aggregator.  The PMCTRL block combines frequency votes from
	  several masters and exposes the winning value to consumers such
	  as CPUfreq and devfreq drivers.

config HISI_DDRC_SEC
	bool "Hisilicon DDR secure protection"
	depends on DRMDRIVER && HISI_BB
	default n
	help
	  Say Y here to enable dynamic DDR secure region programming and
	  DMSS FIQ reporting.  The secure monitor owns the DDR firewall;
	  this driver fills the descriptor in the BL31 shared memory window
	  and issues the matching SMC.

config HISI_SYSCOUNTER
	bool "Hisilicon system counter driver"
	default n
	help
	  Say Y here to enable the HiSilicon always-on system counter.
	  The driver exposes helpers that convert counter timestamps from
	  firmware or remote processors to the kernel's timespec64.

config HISI_NOC
	bool "Hisilicon NoC error monitor"
	depends on HISI_BB
	default n
	help
	  Say yes here to enable the HiSilicon Network-on-Chip (NoC) error
	  monitor.  The driver configures the NoC error probes, collects
	  fault information (initiator/target flow, address, operation and
	  security attributes) and reports it through the platform
	  maintenance (RDR) framework for offline analysis.

config HISI_HHEE
	bool "Hisilicon HHEE hypervisor interface"
	depends on HISI_BB
	depends on ARM64 || COMPILE_TEST
	default n
	help
	  Say yes here to enable the HiSilicon HHEE hypervisor interface.
	  The driver handles exceptions reported by the EL2 firmware over
	  a shared message queue, forwards them to the platform maintenance
	  (RDR) framework, and exposes the firmware log buffers through
	  debugfs.

source "drivers/soc/hisilicon/rdr/Kconfig"

endmenu
```

## drivers/soc/hisilicon/rdr/Kconfig
```kconfig
# Hisilicon mntn (maintenance / exception record) support.
config HISILICON_PLATFORM_MAINTAIN
	bool "Hisilicon platform maintain module support"
	default n
	help
	  Say yes here to support the hisilicon platform maintain module.

config HISI_KERNELDUMP
	bool "Hisilicon kernel dump metadata"
	depends on HISI_MNTNDUMP
	default n
	help
	  Publish kernel image, memmap and memblock metadata into the
	  maintenance dump region for offline crash analysis.

config HISI_MNTNDUMP
	bool "Hisilicon platform mntn dump driver"
	default n
	help
	  Reserve and describe the maintenance dump region used by RDR.

source "drivers/soc/hisilicon/rdr/blackbox/Kconfig"
```
